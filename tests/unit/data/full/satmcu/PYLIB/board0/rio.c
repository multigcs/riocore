// Copyright [2025] <o.dippel@gmx.de>
// Generated by rio-generator

#include <time.h>
#include <unistd.h>
#include <stdint.h>
#include <stdlib.h>
#include <stdbool.h>
#include <stdio.h>
#include <string.h>
#include <math.h>
#include <sys/mman.h>
#include <errno.h>
#include <fcntl.h>
#include <termios.h>

#include <rio.h>

#define MODNAME "riocomp-board0"
#define PREFIX "board0"
#define JOINTS 3
#define BUFFER_SIZE_RX 38
#define BUFFER_SIZE_TX 18
#define OSC_CLOCK 30000000
#define UDP_IP "192.168.11.194"
#define SRC_PORT 2391
#define DST_PORT 2390


struct timespec ns_timestamp;

int64_t rtapi_get_time() {
    clock_gettime(CLOCK_MONOTONIC, &ns_timestamp);
    return (double)ns_timestamp.tv_sec * 1000000000 + ns_timestamp.tv_nsec;
}

void rtapi_delay(int ns) {
    usleep(ns / 1000);
}


static int comp_id;
static const char *modname = MODNAME;
static const char *prefix = PREFIX;

uint32_t pkg_counter = 0;
uint32_t err_total = 0;
uint32_t err_counter = 0;

int64_t stamp_last = 0;
float fpga_stamp_last = 0;
uint32_t fpga_timestamp = 0;

void rio_readwrite(void *inst, int64_t period);
int error_handler(int retval);

#define MAX(a, b) (((a) > (b))?(a):(b))

static data_t *data;

data_t *register_signals(void) {
    int retval = 0;
    data = (data_t*)malloc(sizeof(data_t));
    data->VAROUT32_STEPDIR0_VELOCITY = 0;
    data->VARIN32_STEPDIR0_POSITION = 0;
    data->VAROUT32_STEPDIR1_VELOCITY = 0;
    data->VARIN32_STEPDIR1_POSITION = 0;
    data->VAROUT32_STEPDIR2_VELOCITY = 0;
    data->VARIN32_STEPDIR2_POSITION = 0;
    data->VARIN32_ENCODER0_POSITION = 0;
    data->VARIN32_ENCODER1_POSITION = 0;
    data->VARIN32_ENCODER2_POSITION = 0;
    data->VARIN32_ENCODER3_POSITION = 0;
    data->VAROUT1_STEPDIR0_ENABLE = 0;
    data->VAROUT1_STEPDIR1_ENABLE = 0;
    data->VARIN1_BITIN0_BIT = 0;
    data->VAROUT1_STEPDIR2_ENABLE = 0;
    data->VAROUT1_BITOUT0_BIT = 0;
    data->VAROUT1_BITOUT1_BIT = 0;
    data->VARIN1_BITIN1_BIT = 0;
    data->VARIN1_BITIN2_BIT = 0;
    data->VARIN1_BITIN3_BIT = 0;
    data->VARIN1_BITIN4_BIT = 0;
    data->VARIN1_BITIN5_BIT = 0;
    data->VARIN1_UARTSUB1_TIMEOUT = 0;
    data->VAROUT1_GPIOOUT0_BIT = 0;
    data->VARIN1_UARTSUB0_TIMEOUT = 0;
    data->VAROUT1_GPIOOUT1_BIT = 0;
    data->VAROUT1_GPIOOUT2_BIT = 0;
    data->VAROUT1_GPIOOUT3_BIT = 0;
    data->VARIN1_GPIOIN0_BIT = 0;
    data->VAROUT1_GPIOOUT4_BIT = 0;
    data->VAROUT1_GPIOOUT5_BIT = 0;
    data->VAROUT1_GPIOOUT6_BIT = 0;
    data->VAROUT1_GPIOOUT7_BIT = 0;
    data->VAROUT1_GPIOOUT8_BIT = 0;
    data->VAROUT1_GPIOOUT9_BIT = 0;
    data->VARIN1_GPIOIN1_BIT = 0;

    data->sys_error = (bool*)malloc(sizeof(bool));
    data->sys_status = (bool*)malloc(sizeof(bool));
    data->sys_enable = (bool*)malloc(sizeof(bool));
    data->sys_enable_request = (bool*)malloc(sizeof(bool));
    data->sys_simulation = (bool*)malloc(sizeof(bool));
    *data->sys_simulation = 0;
    data->duration = (float*)malloc(sizeof(float));
    *data->duration = rtapi_get_time();
    data->SIGOUT_BOARD0_STEPDIR0_VELOCITY_SCALE = (float*)malloc(sizeof(float));
    *data->SIGOUT_BOARD0_STEPDIR0_VELOCITY_SCALE = 1.0;
    data->SIGOUT_BOARD0_STEPDIR0_VELOCITY_OFFSET = (float*)malloc(sizeof(float));
    *data->SIGOUT_BOARD0_STEPDIR0_VELOCITY_OFFSET = 0.0;
    data->SIGOUT_BOARD0_STEPDIR0_VELOCITY = (float*)malloc(sizeof(float));
    *data->SIGOUT_BOARD0_STEPDIR0_VELOCITY = 0;
    data->SIGIN_BOARD0_STEPDIR0_POSITION_SCALE = (float*)malloc(sizeof(float));
    *data->SIGIN_BOARD0_STEPDIR0_POSITION_SCALE = 1.0;
    data->SIGIN_BOARD0_STEPDIR0_POSITION_OFFSET = (float*)malloc(sizeof(float));
    *data->SIGIN_BOARD0_STEPDIR0_POSITION_OFFSET = 0.0;
    data->SIGIN_BOARD0_STEPDIR0_POSITION = (float*)malloc(sizeof(float));
    *data->SIGIN_BOARD0_STEPDIR0_POSITION = 0;
    data->SIGIN_BOARD0_STEPDIR0_POSITION_ABS = (float*)malloc(sizeof(float));
    *data->SIGIN_BOARD0_STEPDIR0_POSITION_ABS = 0;
    data->SIGIN_BOARD0_STEPDIR0_POSITION_S32 = (int32_t*)malloc(sizeof(int32_t));
    *data->SIGIN_BOARD0_STEPDIR0_POSITION_S32 = 0;
    data->SIGIN_BOARD0_STEPDIR0_POSITION_U32_ABS = (uint32_t*)malloc(sizeof(uint32_t));
    *data->SIGIN_BOARD0_STEPDIR0_POSITION_U32_ABS = 0;
    data->SIGOUT_BOARD0_STEPDIR0_ENABLE = (bool*)malloc(sizeof(bool));
    *data->SIGOUT_BOARD0_STEPDIR0_ENABLE = 0;
    data->SIGOUT_BOARD0_STEPDIR1_VELOCITY_SCALE = (float*)malloc(sizeof(float));
    *data->SIGOUT_BOARD0_STEPDIR1_VELOCITY_SCALE = 1.0;
    data->SIGOUT_BOARD0_STEPDIR1_VELOCITY_OFFSET = (float*)malloc(sizeof(float));
    *data->SIGOUT_BOARD0_STEPDIR1_VELOCITY_OFFSET = 0.0;
    data->SIGOUT_BOARD0_STEPDIR1_VELOCITY = (float*)malloc(sizeof(float));
    *data->SIGOUT_BOARD0_STEPDIR1_VELOCITY = 0;
    data->SIGIN_BOARD0_STEPDIR1_POSITION_SCALE = (float*)malloc(sizeof(float));
    *data->SIGIN_BOARD0_STEPDIR1_POSITION_SCALE = 1.0;
    data->SIGIN_BOARD0_STEPDIR1_POSITION_OFFSET = (float*)malloc(sizeof(float));
    *data->SIGIN_BOARD0_STEPDIR1_POSITION_OFFSET = 0.0;
    data->SIGIN_BOARD0_STEPDIR1_POSITION = (float*)malloc(sizeof(float));
    *data->SIGIN_BOARD0_STEPDIR1_POSITION = 0;
    data->SIGIN_BOARD0_STEPDIR1_POSITION_ABS = (float*)malloc(sizeof(float));
    *data->SIGIN_BOARD0_STEPDIR1_POSITION_ABS = 0;
    data->SIGIN_BOARD0_STEPDIR1_POSITION_S32 = (int32_t*)malloc(sizeof(int32_t));
    *data->SIGIN_BOARD0_STEPDIR1_POSITION_S32 = 0;
    data->SIGIN_BOARD0_STEPDIR1_POSITION_U32_ABS = (uint32_t*)malloc(sizeof(uint32_t));
    *data->SIGIN_BOARD0_STEPDIR1_POSITION_U32_ABS = 0;
    data->SIGOUT_BOARD0_STEPDIR1_ENABLE = (bool*)malloc(sizeof(bool));
    *data->SIGOUT_BOARD0_STEPDIR1_ENABLE = 0;
    data->SIGIN_BOARD0_BITIN0_BIT = (bool*)malloc(sizeof(bool));
    *data->SIGIN_BOARD0_BITIN0_BIT = 0;
    data->SIGIN_BOARD0_BITIN0_BIT_not = (bool*)malloc(sizeof(bool));
    *data->SIGIN_BOARD0_BITIN0_BIT_not = 1 - *data->SIGIN_BOARD0_BITIN0_BIT;
    data->SIGOUT_BOARD0_STEPDIR2_VELOCITY_SCALE = (float*)malloc(sizeof(float));
    *data->SIGOUT_BOARD0_STEPDIR2_VELOCITY_SCALE = 1.0;
    data->SIGOUT_BOARD0_STEPDIR2_VELOCITY_OFFSET = (float*)malloc(sizeof(float));
    *data->SIGOUT_BOARD0_STEPDIR2_VELOCITY_OFFSET = 0.0;
    data->SIGOUT_BOARD0_STEPDIR2_VELOCITY = (float*)malloc(sizeof(float));
    *data->SIGOUT_BOARD0_STEPDIR2_VELOCITY = 0;
    data->SIGIN_BOARD0_STEPDIR2_POSITION_SCALE = (float*)malloc(sizeof(float));
    *data->SIGIN_BOARD0_STEPDIR2_POSITION_SCALE = 1.0;
    data->SIGIN_BOARD0_STEPDIR2_POSITION_OFFSET = (float*)malloc(sizeof(float));
    *data->SIGIN_BOARD0_STEPDIR2_POSITION_OFFSET = 0.0;
    data->SIGIN_BOARD0_STEPDIR2_POSITION = (float*)malloc(sizeof(float));
    *data->SIGIN_BOARD0_STEPDIR2_POSITION = 0;
    data->SIGIN_BOARD0_STEPDIR2_POSITION_ABS = (float*)malloc(sizeof(float));
    *data->SIGIN_BOARD0_STEPDIR2_POSITION_ABS = 0;
    data->SIGIN_BOARD0_STEPDIR2_POSITION_S32 = (int32_t*)malloc(sizeof(int32_t));
    *data->SIGIN_BOARD0_STEPDIR2_POSITION_S32 = 0;
    data->SIGIN_BOARD0_STEPDIR2_POSITION_U32_ABS = (uint32_t*)malloc(sizeof(uint32_t));
    *data->SIGIN_BOARD0_STEPDIR2_POSITION_U32_ABS = 0;
    data->SIGOUT_BOARD0_STEPDIR2_ENABLE = (bool*)malloc(sizeof(bool));
    *data->SIGOUT_BOARD0_STEPDIR2_ENABLE = 0;
    data->SIGOUT_BOARD0_BITOUT0_BIT = (bool*)malloc(sizeof(bool));
    *data->SIGOUT_BOARD0_BITOUT0_BIT = 0;
    data->SIGOUT_BOARD0_BITOUT1_BIT = (bool*)malloc(sizeof(bool));
    *data->SIGOUT_BOARD0_BITOUT1_BIT = 0;
    data->SIGIN_BOARD0_BITIN1_BIT = (bool*)malloc(sizeof(bool));
    *data->SIGIN_BOARD0_BITIN1_BIT = 0;
    data->SIGIN_BOARD0_BITIN1_BIT_not = (bool*)malloc(sizeof(bool));
    *data->SIGIN_BOARD0_BITIN1_BIT_not = 1 - *data->SIGIN_BOARD0_BITIN1_BIT;
    data->SIGIN_BOARD0_BITIN2_BIT = (bool*)malloc(sizeof(bool));
    *data->SIGIN_BOARD0_BITIN2_BIT = 0;
    data->SIGIN_BOARD0_BITIN2_BIT_not = (bool*)malloc(sizeof(bool));
    *data->SIGIN_BOARD0_BITIN2_BIT_not = 1 - *data->SIGIN_BOARD0_BITIN2_BIT;
    data->SIGIN_BOARD0_BITIN3_BIT = (bool*)malloc(sizeof(bool));
    *data->SIGIN_BOARD0_BITIN3_BIT = 0;
    data->SIGIN_BOARD0_BITIN3_BIT_not = (bool*)malloc(sizeof(bool));
    *data->SIGIN_BOARD0_BITIN3_BIT_not = 1 - *data->SIGIN_BOARD0_BITIN3_BIT;
    data->SIGIN_BOARD0_BITIN4_BIT = (bool*)malloc(sizeof(bool));
    *data->SIGIN_BOARD0_BITIN4_BIT = 0;
    data->SIGIN_BOARD0_BITIN4_BIT_not = (bool*)malloc(sizeof(bool));
    *data->SIGIN_BOARD0_BITIN4_BIT_not = 1 - *data->SIGIN_BOARD0_BITIN4_BIT;
    data->SIGIN_BOARD0_BITIN5_BIT = (bool*)malloc(sizeof(bool));
    *data->SIGIN_BOARD0_BITIN5_BIT = 0;
    data->SIGIN_BOARD0_BITIN5_BIT_not = (bool*)malloc(sizeof(bool));
    *data->SIGIN_BOARD0_BITIN5_BIT_not = 1 - *data->SIGIN_BOARD0_BITIN5_BIT;
    data->SIGIN_BOARD0_UARTSUB1_TIMEOUT = (bool*)malloc(sizeof(bool));
    *data->SIGIN_BOARD0_UARTSUB1_TIMEOUT = 0;
    data->SIGIN_BOARD0_UARTSUB1_TIMEOUT_not = (bool*)malloc(sizeof(bool));
    *data->SIGIN_BOARD0_UARTSUB1_TIMEOUT_not = 1 - *data->SIGIN_BOARD0_UARTSUB1_TIMEOUT;
    data->SIGOUT_BOARD0_SATMCU0_GPIOOUT0_BIT = (bool*)malloc(sizeof(bool));
    *data->SIGOUT_BOARD0_SATMCU0_GPIOOUT0_BIT = 0;
    data->SIGIN_BOARD0_UARTSUB0_TIMEOUT = (bool*)malloc(sizeof(bool));
    *data->SIGIN_BOARD0_UARTSUB0_TIMEOUT = 0;
    data->SIGIN_BOARD0_UARTSUB0_TIMEOUT_not = (bool*)malloc(sizeof(bool));
    *data->SIGIN_BOARD0_UARTSUB0_TIMEOUT_not = 1 - *data->SIGIN_BOARD0_UARTSUB0_TIMEOUT;
    data->SIGOUT_BOARD0_SATMCU0_GPIOOUT1_BIT = (bool*)malloc(sizeof(bool));
    *data->SIGOUT_BOARD0_SATMCU0_GPIOOUT1_BIT = 0;
    data->SIGOUT_BOARD0_SATMCU0_GPIOOUT2_BIT = (bool*)malloc(sizeof(bool));
    *data->SIGOUT_BOARD0_SATMCU0_GPIOOUT2_BIT = 0;
    data->SIGOUT_BOARD0_SATMCU0_GPIOOUT3_BIT = (bool*)malloc(sizeof(bool));
    *data->SIGOUT_BOARD0_SATMCU0_GPIOOUT3_BIT = 0;
    data->SIGIN_BOARD0_SATMCU0_GPIOIN0_BIT = (bool*)malloc(sizeof(bool));
    *data->SIGIN_BOARD0_SATMCU0_GPIOIN0_BIT = 0;
    data->SIGIN_BOARD0_SATMCU0_GPIOIN0_BIT_not = (bool*)malloc(sizeof(bool));
    *data->SIGIN_BOARD0_SATMCU0_GPIOIN0_BIT_not = 1 - *data->SIGIN_BOARD0_SATMCU0_GPIOIN0_BIT;
    data->SIGIN_BOARD0_SATMCU0_ENCODER0_POSITION_SCALE = (float*)malloc(sizeof(float));
    *data->SIGIN_BOARD0_SATMCU0_ENCODER0_POSITION_SCALE = 1.0;
    data->SIGIN_BOARD0_SATMCU0_ENCODER0_POSITION_OFFSET = (float*)malloc(sizeof(float));
    *data->SIGIN_BOARD0_SATMCU0_ENCODER0_POSITION_OFFSET = 0.0;
    data->SIGIN_BOARD0_SATMCU0_ENCODER0_POSITION = (float*)malloc(sizeof(float));
    *data->SIGIN_BOARD0_SATMCU0_ENCODER0_POSITION = 0;
    data->SIGIN_BOARD0_SATMCU0_ENCODER0_POSITION_ABS = (float*)malloc(sizeof(float));
    *data->SIGIN_BOARD0_SATMCU0_ENCODER0_POSITION_ABS = 0;
    data->SIGIN_BOARD0_SATMCU0_ENCODER0_POSITION_S32 = (int32_t*)malloc(sizeof(int32_t));
    *data->SIGIN_BOARD0_SATMCU0_ENCODER0_POSITION_S32 = 0;
    data->SIGIN_BOARD0_SATMCU0_ENCODER0_POSITION_U32_ABS = (uint32_t*)malloc(sizeof(uint32_t));
    *data->SIGIN_BOARD0_SATMCU0_ENCODER0_POSITION_U32_ABS = 0;
    data->SIGIN_BOARD0_SATMCU0_ENCODER0_VELOCITY = (float*)malloc(sizeof(float));
    *data->SIGIN_BOARD0_SATMCU0_ENCODER0_VELOCITY = 0;
    data->SIGIN_BOARD0_SATMCU0_ENCODER0_VELOCITY_RPM = (float*)malloc(sizeof(float));
    *data->SIGIN_BOARD0_SATMCU0_ENCODER0_VELOCITY_RPM = 0;
    data->SIGIN_BOARD0_SATMCU0_ENCODER1_POSITION_SCALE = (float*)malloc(sizeof(float));
    *data->SIGIN_BOARD0_SATMCU0_ENCODER1_POSITION_SCALE = 1.0;
    data->SIGIN_BOARD0_SATMCU0_ENCODER1_POSITION_OFFSET = (float*)malloc(sizeof(float));
    *data->SIGIN_BOARD0_SATMCU0_ENCODER1_POSITION_OFFSET = 0.0;
    data->SIGIN_BOARD0_SATMCU0_ENCODER1_POSITION = (float*)malloc(sizeof(float));
    *data->SIGIN_BOARD0_SATMCU0_ENCODER1_POSITION = 0;
    data->SIGIN_BOARD0_SATMCU0_ENCODER1_POSITION_ABS = (float*)malloc(sizeof(float));
    *data->SIGIN_BOARD0_SATMCU0_ENCODER1_POSITION_ABS = 0;
    data->SIGIN_BOARD0_SATMCU0_ENCODER1_POSITION_S32 = (int32_t*)malloc(sizeof(int32_t));
    *data->SIGIN_BOARD0_SATMCU0_ENCODER1_POSITION_S32 = 0;
    data->SIGIN_BOARD0_SATMCU0_ENCODER1_POSITION_U32_ABS = (uint32_t*)malloc(sizeof(uint32_t));
    *data->SIGIN_BOARD0_SATMCU0_ENCODER1_POSITION_U32_ABS = 0;
    data->SIGIN_BOARD0_SATMCU0_ENCODER1_VELOCITY = (float*)malloc(sizeof(float));
    *data->SIGIN_BOARD0_SATMCU0_ENCODER1_VELOCITY = 0;
    data->SIGIN_BOARD0_SATMCU0_ENCODER1_VELOCITY_RPM = (float*)malloc(sizeof(float));
    *data->SIGIN_BOARD0_SATMCU0_ENCODER1_VELOCITY_RPM = 0;
    data->SIGIN_BOARD0_SATMCU0_ENCODER2_POSITION_SCALE = (float*)malloc(sizeof(float));
    *data->SIGIN_BOARD0_SATMCU0_ENCODER2_POSITION_SCALE = 1.0;
    data->SIGIN_BOARD0_SATMCU0_ENCODER2_POSITION_OFFSET = (float*)malloc(sizeof(float));
    *data->SIGIN_BOARD0_SATMCU0_ENCODER2_POSITION_OFFSET = 0.0;
    data->SIGIN_BOARD0_SATMCU0_ENCODER2_POSITION = (float*)malloc(sizeof(float));
    *data->SIGIN_BOARD0_SATMCU0_ENCODER2_POSITION = 0;
    data->SIGIN_BOARD0_SATMCU0_ENCODER2_POSITION_ABS = (float*)malloc(sizeof(float));
    *data->SIGIN_BOARD0_SATMCU0_ENCODER2_POSITION_ABS = 0;
    data->SIGIN_BOARD0_SATMCU0_ENCODER2_POSITION_S32 = (int32_t*)malloc(sizeof(int32_t));
    *data->SIGIN_BOARD0_SATMCU0_ENCODER2_POSITION_S32 = 0;
    data->SIGIN_BOARD0_SATMCU0_ENCODER2_POSITION_U32_ABS = (uint32_t*)malloc(sizeof(uint32_t));
    *data->SIGIN_BOARD0_SATMCU0_ENCODER2_POSITION_U32_ABS = 0;
    data->SIGIN_BOARD0_SATMCU0_ENCODER2_VELOCITY = (float*)malloc(sizeof(float));
    *data->SIGIN_BOARD0_SATMCU0_ENCODER2_VELOCITY = 0;
    data->SIGIN_BOARD0_SATMCU0_ENCODER2_VELOCITY_RPM = (float*)malloc(sizeof(float));
    *data->SIGIN_BOARD0_SATMCU0_ENCODER2_VELOCITY_RPM = 0;
    data->SIGIN_BOARD0_SATMCU0_ENCODER3_POSITION_SCALE = (float*)malloc(sizeof(float));
    *data->SIGIN_BOARD0_SATMCU0_ENCODER3_POSITION_SCALE = 1.0;
    data->SIGIN_BOARD0_SATMCU0_ENCODER3_POSITION_OFFSET = (float*)malloc(sizeof(float));
    *data->SIGIN_BOARD0_SATMCU0_ENCODER3_POSITION_OFFSET = 0.0;
    data->SIGIN_BOARD0_SATMCU0_ENCODER3_POSITION = (float*)malloc(sizeof(float));
    *data->SIGIN_BOARD0_SATMCU0_ENCODER3_POSITION = 0;
    data->SIGIN_BOARD0_SATMCU0_ENCODER3_POSITION_ABS = (float*)malloc(sizeof(float));
    *data->SIGIN_BOARD0_SATMCU0_ENCODER3_POSITION_ABS = 0;
    data->SIGIN_BOARD0_SATMCU0_ENCODER3_POSITION_S32 = (int32_t*)malloc(sizeof(int32_t));
    *data->SIGIN_BOARD0_SATMCU0_ENCODER3_POSITION_S32 = 0;
    data->SIGIN_BOARD0_SATMCU0_ENCODER3_POSITION_U32_ABS = (uint32_t*)malloc(sizeof(uint32_t));
    *data->SIGIN_BOARD0_SATMCU0_ENCODER3_POSITION_U32_ABS = 0;
    data->SIGIN_BOARD0_SATMCU0_ENCODER3_VELOCITY = (float*)malloc(sizeof(float));
    *data->SIGIN_BOARD0_SATMCU0_ENCODER3_VELOCITY = 0;
    data->SIGIN_BOARD0_SATMCU0_ENCODER3_VELOCITY_RPM = (float*)malloc(sizeof(float));
    *data->SIGIN_BOARD0_SATMCU0_ENCODER3_VELOCITY_RPM = 0;
    data->SIGOUT_BOARD0_SATMCU0_GPIOOUT4_BIT = (bool*)malloc(sizeof(bool));
    *data->SIGOUT_BOARD0_SATMCU0_GPIOOUT4_BIT = 0;
    data->SIGOUT_BOARD0_SATMCU0_GPIOOUT5_BIT = (bool*)malloc(sizeof(bool));
    *data->SIGOUT_BOARD0_SATMCU0_GPIOOUT5_BIT = 0;
    data->SIGOUT_BOARD0_SATMCU0_GPIOOUT6_BIT = (bool*)malloc(sizeof(bool));
    *data->SIGOUT_BOARD0_SATMCU0_GPIOOUT6_BIT = 0;
    data->SIGOUT_BOARD0_SATMCU0_GPIOOUT7_BIT = (bool*)malloc(sizeof(bool));
    *data->SIGOUT_BOARD0_SATMCU0_GPIOOUT7_BIT = 0;
    data->SIGOUT_BOARD0_SATMCU0_GPIOOUT8_BIT = (bool*)malloc(sizeof(bool));
    *data->SIGOUT_BOARD0_SATMCU0_GPIOOUT8_BIT = 0;
    data->SIGOUT_BOARD0_SATMCU1_GPIOOUT9_BIT = (bool*)malloc(sizeof(bool));
    *data->SIGOUT_BOARD0_SATMCU1_GPIOOUT9_BIT = 0;
    data->SIGIN_BOARD0_SATMCU1_GPIOIN1_BIT = (bool*)malloc(sizeof(bool));
    *data->SIGIN_BOARD0_SATMCU1_GPIOIN1_BIT = 0;
    data->SIGIN_BOARD0_SATMCU1_GPIOIN1_BIT_not = (bool*)malloc(sizeof(bool));
    *data->SIGIN_BOARD0_SATMCU1_GPIOIN1_BIT_not = 1 - *data->SIGIN_BOARD0_SATMCU1_GPIOIN1_BIT;
    return data;
}

/*
    interface: UDP
*/

#include <sys/socket.h>
#include <arpa/inet.h>
#include <netinet/in.h>

#define SEND_TIMEOUT_US 10
#define RECV_TIMEOUT_US 10
#define READ_PCK_DELAY_NS 1000
#define READ_PCK_TIMEOUT_MS 2

static int udpSocket;
static int errCount;
struct sockaddr_in dstAddr, srcAddr;
struct hostent *server;

int udp_init(const char *dstAddress, int dstPort, int srcPort) {
    int ret;

    // Create a UDP socket
    udpSocket = socket(PF_INET, SOCK_DGRAM, IPPROTO_UDP);
    if (udpSocket < 0) {
        printf("ERROR: can't open socket: %s\n", "error");
        return -1;
    }

    bzero((char*) &dstAddr, sizeof(dstAddr));
    dstAddr.sin_family = AF_INET;
    dstAddr.sin_addr.s_addr = inet_addr(dstAddress);
    dstAddr.sin_port = htons(dstPort);

    bzero((char*) &srcAddr, sizeof(srcAddr));
    srcAddr.sin_family = AF_INET;
    srcAddr.sin_addr.s_addr = htonl(INADDR_ANY);
    srcAddr.sin_port = htons(srcPort);

    printf("INFO: target is udp port: %s:%i\n", dstAddress, dstPort);
    printf("INFO: listening on udp port: %s:%i\n", "0.0.0.0", srcPort);

    // bind the local socket to SCR_PORT
    ret = bind(udpSocket, (struct sockaddr *) &srcAddr, sizeof(srcAddr));
    if (ret < 0) {
        printf("ERROR: can't bind: %s\n", "error");
        return -1;
    }

    // Connect to send and receive only to the server_addr
    ret = connect(udpSocket, (struct sockaddr*) &dstAddr, sizeof(struct sockaddr_in));
    if (ret < 0) {
        printf("ERROR: can't connect: %s\n", "error");
        return -1;
    }

    struct timeval timeout;
    timeout.tv_sec = 0;
    timeout.tv_usec = RECV_TIMEOUT_US;

    ret = setsockopt(udpSocket, SOL_SOCKET, SO_RCVTIMEO, (char*) &timeout, sizeof(timeout));
    if (ret < 0) {
        printf("ERROR: can't set receive timeout socket option: %s\n", "error");
        return -1;
    }

    timeout.tv_usec = SEND_TIMEOUT_US;
    ret = setsockopt(udpSocket, SOL_SOCKET, SO_SNDTIMEO, (char*) &timeout,
                     sizeof(timeout));
    if (ret < 0) {
        printf("ERROR: can't set send timeout socket option: %s\n", "error");
        return -1;
    }

    return 0;
}

void udp_tx(uint8_t *txBuffer, uint16_t size) {
    // Send datagram
    send(udpSocket, txBuffer, size, 0);
}

int udp_rx(uint8_t *rxBuffer, uint16_t size, uint8_t udp_async) {
    int i;
    int ret;
    int64_t t1;
    int64_t t2;
    uint8_t rxBufferTmp[1024];

    for (i = 0; i < 1024; i++) {
        rxBufferTmp[i] = 0;
    }

    // Receive incoming datagram
    if (udp_async == 1) {
        ret = recv(udpSocket, rxBufferTmp, size * 2, MSG_DONTWAIT);
    } else {
        t1 = rtapi_get_time();
        do {
            ret = recv(udpSocket, rxBufferTmp, size * 2, 0);
            if (ret < 0) {
                rtapi_delay(READ_PCK_DELAY_NS);
            }
            t2 = rtapi_get_time();
        }
        while ((ret < 0) && ((t2 - t1) < READ_PCK_TIMEOUT_MS * 1000 * 1000));
    }

    if (ret > 0) {
        errCount = 0;
        if (ret == size) {
            memcpy(rxBuffer, rxBufferTmp, size);
        } else {
            printf("wrong size = %d\n", ret);
            for (i = 0; i < ret; i++) {
                printf("%d ", rxBufferTmp[i]);
            }
            printf("\n");
        }
        /*
        printf("rx:");
        for (i = 0; i < ret; i++) {
            printf(" %d,", rxBuffer[i]);
        }
        printf("\n");
        */
    } else {
        errCount++;
        // printf("Ethernet TIMEOUT: N = %d (ret: %d)\n", errCount, ret);
    }

    return ret;
}

void udp_exit(void) {
}

int interface_init(int argc, char **argv) {
    char dstAddress[20];
    int dstPort = DST_PORT;
    if (argc > 1) {
        int ip0 = 0;
        int ip1 = 0;
        int ip2 = 0;
        int ip3 = 0;
        int port = 0;
        int ret = sscanf(argv[1], "%d.%d.%d.%d:%d", &ip0, &ip1, &ip2, &ip3, &port);
        if (ret >= 4) {
            snprintf(dstAddress, sizeof(dstAddress), "%d.%d.%d.%d", ip0, ip1, ip2, ip3);
            if (ret == 5) {
                dstPort = port;
            }
        }
        udp_init(dstAddress, dstPort, SRC_PORT);
    } else {
        udp_init(UDP_IP, DST_PORT, SRC_PORT);
    }
    return 0;
}

data_t *init(int argc, char **argv) {
    data = register_signals();
    interface_init(argc, argv);
    return data;
}

void interface_exit(void) {
    udp_exit();
}


/*
    hal functions
*/

/***********************************************************************
*                       HELPER FUNCTIONS                               *
************************************************************************/

uint16_t crc16_update(uint16_t crc, uint8_t a) {
    int i;

    crc ^= (uint16_t)a;
    for (i = 0; i < 8; ++i) {
        if (crc & 1)
            crc = (crc >> 1) ^ 0xA001;
        else
            crc = (crc >> 1);
    }

    return crc;
}


/***********************************************************************/


/***********************************************************************
*                         PLUGIN GLOBALS                               *
************************************************************************/




































/***********************************************************************/

// Generated by component_signal_converter()
// output: SIGOUT -> calc -> VAROUT -> txBuffer
void convert_varout32_stepdir0_velocity(data_t *data) {
    float value = *data->SIGOUT_BOARD0_STEPDIR0_VELOCITY;
    value = value * *data->SIGOUT_BOARD0_STEPDIR0_VELOCITY_SCALE;
    value = value + *data->SIGOUT_BOARD0_STEPDIR0_VELOCITY_OFFSET;
    if (value != 0) {
        value = OSC_CLOCK / value / 2;
    }
    data->VAROUT32_STEPDIR0_VELOCITY = value;
}

void convert_varout1_stepdir0_enable(data_t *data) {
    bool value = *data->SIGOUT_BOARD0_STEPDIR0_ENABLE;
    data->VAROUT1_STEPDIR0_ENABLE = value;
}

void convert_varout32_stepdir1_velocity(data_t *data) {
    float value = *data->SIGOUT_BOARD0_STEPDIR1_VELOCITY;
    value = value * *data->SIGOUT_BOARD0_STEPDIR1_VELOCITY_SCALE;
    value = value + *data->SIGOUT_BOARD0_STEPDIR1_VELOCITY_OFFSET;
    if (value != 0) {
        value = OSC_CLOCK / value / 2;
    }
    data->VAROUT32_STEPDIR1_VELOCITY = value;
}

void convert_varout1_stepdir1_enable(data_t *data) {
    bool value = *data->SIGOUT_BOARD0_STEPDIR1_ENABLE;
    data->VAROUT1_STEPDIR1_ENABLE = value;
}

void convert_varout32_stepdir2_velocity(data_t *data) {
    float value = *data->SIGOUT_BOARD0_STEPDIR2_VELOCITY;
    value = value * *data->SIGOUT_BOARD0_STEPDIR2_VELOCITY_SCALE;
    value = value + *data->SIGOUT_BOARD0_STEPDIR2_VELOCITY_OFFSET;
    if (value != 0) {
        value = OSC_CLOCK / value / 2;
    }
    data->VAROUT32_STEPDIR2_VELOCITY = value;
}

void convert_varout1_stepdir2_enable(data_t *data) {
    bool value = *data->SIGOUT_BOARD0_STEPDIR2_ENABLE;
    data->VAROUT1_STEPDIR2_ENABLE = value;
}

void convert_varout1_bitout0_bit(data_t *data) {
    bool value = *data->SIGOUT_BOARD0_BITOUT0_BIT;
    data->VAROUT1_BITOUT0_BIT = value;
}

void convert_varout1_bitout1_bit(data_t *data) {
    bool value = *data->SIGOUT_BOARD0_BITOUT1_BIT;
    data->VAROUT1_BITOUT1_BIT = value;
}

void convert_varout1_gpioout0_bit(data_t *data) {
    bool value = *data->SIGOUT_BOARD0_SATMCU0_GPIOOUT0_BIT;
    data->VAROUT1_GPIOOUT0_BIT = value;
}

void convert_varout1_gpioout1_bit(data_t *data) {
    bool value = *data->SIGOUT_BOARD0_SATMCU0_GPIOOUT1_BIT;
    data->VAROUT1_GPIOOUT1_BIT = value;
}

void convert_varout1_gpioout2_bit(data_t *data) {
    bool value = *data->SIGOUT_BOARD0_SATMCU0_GPIOOUT2_BIT;
    data->VAROUT1_GPIOOUT2_BIT = value;
}

void convert_varout1_gpioout3_bit(data_t *data) {
    bool value = *data->SIGOUT_BOARD0_SATMCU0_GPIOOUT3_BIT;
    data->VAROUT1_GPIOOUT3_BIT = value;
}

void convert_varout1_gpioout4_bit(data_t *data) {
    bool value = *data->SIGOUT_BOARD0_SATMCU0_GPIOOUT4_BIT;
    data->VAROUT1_GPIOOUT4_BIT = value;
}

void convert_varout1_gpioout5_bit(data_t *data) {
    bool value = *data->SIGOUT_BOARD0_SATMCU0_GPIOOUT5_BIT;
    data->VAROUT1_GPIOOUT5_BIT = value;
}

void convert_varout1_gpioout6_bit(data_t *data) {
    bool value = *data->SIGOUT_BOARD0_SATMCU0_GPIOOUT6_BIT;
    data->VAROUT1_GPIOOUT6_BIT = value;
}

void convert_varout1_gpioout7_bit(data_t *data) {
    bool value = *data->SIGOUT_BOARD0_SATMCU0_GPIOOUT7_BIT;
    data->VAROUT1_GPIOOUT7_BIT = value;
}

void convert_varout1_gpioout8_bit(data_t *data) {
    bool value = *data->SIGOUT_BOARD0_SATMCU0_GPIOOUT8_BIT;
    data->VAROUT1_GPIOOUT8_BIT = value;
}

void convert_varout1_gpioout9_bit(data_t *data) {
    bool value = *data->SIGOUT_BOARD0_SATMCU1_GPIOOUT9_BIT;
    data->VAROUT1_GPIOOUT9_BIT = value;
}


// input: rxBuffer -> VAROUT -> calc -> SIGOUT
void convert_sigin_board0_stepdir0_position(data_t *data) {
    float value = data->VARIN32_STEPDIR0_POSITION;
    float offset = *data->SIGIN_BOARD0_STEPDIR0_POSITION_OFFSET;
    float scale = *data->SIGIN_BOARD0_STEPDIR0_POSITION_SCALE;
    value = value + offset;
    value = value / scale;
    if (*data->sys_simulation == 1) {
        value = *data->SIGIN_BOARD0_STEPDIR0_POSITION + *data->SIGOUT_BOARD0_STEPDIR0_VELOCITY / 1000.0;
    }
    *data->SIGIN_BOARD0_STEPDIR0_POSITION_ABS = fabs(value);
    *data->SIGIN_BOARD0_STEPDIR0_POSITION_S32 = value;
    *data->SIGIN_BOARD0_STEPDIR0_POSITION_U32_ABS = fabs(value);
    *data->SIGIN_BOARD0_STEPDIR0_POSITION = value;
}

void convert_sigin_board0_stepdir1_position(data_t *data) {
    float value = data->VARIN32_STEPDIR1_POSITION;
    float offset = *data->SIGIN_BOARD0_STEPDIR1_POSITION_OFFSET;
    float scale = *data->SIGIN_BOARD0_STEPDIR1_POSITION_SCALE;
    value = value + offset;
    value = value / scale;
    if (*data->sys_simulation == 1) {
        value = *data->SIGIN_BOARD0_STEPDIR1_POSITION + *data->SIGOUT_BOARD0_STEPDIR1_VELOCITY / 1000.0;
    }
    *data->SIGIN_BOARD0_STEPDIR1_POSITION_ABS = fabs(value);
    *data->SIGIN_BOARD0_STEPDIR1_POSITION_S32 = value;
    *data->SIGIN_BOARD0_STEPDIR1_POSITION_U32_ABS = fabs(value);
    *data->SIGIN_BOARD0_STEPDIR1_POSITION = value;
}

void convert_sigin_board0_bitin0_bit(data_t *data) {
    bool value = data->VARIN1_BITIN0_BIT;
    *data->SIGIN_BOARD0_BITIN0_BIT = value;
    *data->SIGIN_BOARD0_BITIN0_BIT_not = 1 - value;
}

void convert_sigin_board0_stepdir2_position(data_t *data) {
    float value = data->VARIN32_STEPDIR2_POSITION;
    float offset = *data->SIGIN_BOARD0_STEPDIR2_POSITION_OFFSET;
    float scale = *data->SIGIN_BOARD0_STEPDIR2_POSITION_SCALE;
    value = value + offset;
    value = value / scale;
    if (*data->sys_simulation == 1) {
        value = *data->SIGIN_BOARD0_STEPDIR2_POSITION + *data->SIGOUT_BOARD0_STEPDIR2_VELOCITY / 1000.0;
    }
    *data->SIGIN_BOARD0_STEPDIR2_POSITION_ABS = fabs(value);
    *data->SIGIN_BOARD0_STEPDIR2_POSITION_S32 = value;
    *data->SIGIN_BOARD0_STEPDIR2_POSITION_U32_ABS = fabs(value);
    *data->SIGIN_BOARD0_STEPDIR2_POSITION = value;
}

void convert_sigin_board0_bitin1_bit(data_t *data) {
    bool value = data->VARIN1_BITIN1_BIT;
    *data->SIGIN_BOARD0_BITIN1_BIT = value;
    *data->SIGIN_BOARD0_BITIN1_BIT_not = 1 - value;
}

void convert_sigin_board0_bitin2_bit(data_t *data) {
    bool value = data->VARIN1_BITIN2_BIT;
    *data->SIGIN_BOARD0_BITIN2_BIT = value;
    *data->SIGIN_BOARD0_BITIN2_BIT_not = 1 - value;
}

void convert_sigin_board0_bitin3_bit(data_t *data) {
    bool value = data->VARIN1_BITIN3_BIT;
    *data->SIGIN_BOARD0_BITIN3_BIT = value;
    *data->SIGIN_BOARD0_BITIN3_BIT_not = 1 - value;
}

void convert_sigin_board0_bitin4_bit(data_t *data) {
    bool value = data->VARIN1_BITIN4_BIT;
    *data->SIGIN_BOARD0_BITIN4_BIT = value;
    *data->SIGIN_BOARD0_BITIN4_BIT_not = 1 - value;
}

void convert_sigin_board0_bitin5_bit(data_t *data) {
    bool value = data->VARIN1_BITIN5_BIT;
    *data->SIGIN_BOARD0_BITIN5_BIT = value;
    *data->SIGIN_BOARD0_BITIN5_BIT_not = 1 - value;
}

void convert_sigin_board0_uartsub1_timeout(data_t *data) {
    bool value = data->VARIN1_UARTSUB1_TIMEOUT;
    *data->SIGIN_BOARD0_UARTSUB1_TIMEOUT = value;
    *data->SIGIN_BOARD0_UARTSUB1_TIMEOUT_not = 1 - value;
}

void convert_sigin_board0_uartsub0_timeout(data_t *data) {
    bool value = data->VARIN1_UARTSUB0_TIMEOUT;
    *data->SIGIN_BOARD0_UARTSUB0_TIMEOUT = value;
    *data->SIGIN_BOARD0_UARTSUB0_TIMEOUT_not = 1 - value;
}

void convert_sigin_board0_satmcu0_gpioin0_bit(data_t *data) {
    bool value = data->VARIN1_GPIOIN0_BIT;
    *data->SIGIN_BOARD0_SATMCU0_GPIOIN0_BIT = value;
    *data->SIGIN_BOARD0_SATMCU0_GPIOIN0_BIT_not = 1 - value;
}

void convert_sigin_board0_satmcu0_encoder0_position(data_t *data) {
    float value = data->VARIN32_ENCODER0_POSITION;
    float offset = *data->SIGIN_BOARD0_SATMCU0_ENCODER0_POSITION_OFFSET;
    float scale = *data->SIGIN_BOARD0_SATMCU0_ENCODER0_POSITION_SCALE;
    value = value + offset;
    value = value / scale;
    *data->SIGIN_BOARD0_SATMCU0_ENCODER0_POSITION_ABS = fabs(value);
    *data->SIGIN_BOARD0_SATMCU0_ENCODER0_POSITION_S32 = value;
    *data->SIGIN_BOARD0_SATMCU0_ENCODER0_POSITION_U32_ABS = fabs(value);
    *data->SIGIN_BOARD0_SATMCU0_ENCODER0_POSITION = value;
}

void convert_sigin_board0_satmcu0_encoder1_position(data_t *data) {
    float value = data->VARIN32_ENCODER1_POSITION;
    float offset = *data->SIGIN_BOARD0_SATMCU0_ENCODER1_POSITION_OFFSET;
    float scale = *data->SIGIN_BOARD0_SATMCU0_ENCODER1_POSITION_SCALE;
    value = value + offset;
    value = value / scale;
    *data->SIGIN_BOARD0_SATMCU0_ENCODER1_POSITION_ABS = fabs(value);
    *data->SIGIN_BOARD0_SATMCU0_ENCODER1_POSITION_S32 = value;
    *data->SIGIN_BOARD0_SATMCU0_ENCODER1_POSITION_U32_ABS = fabs(value);
    *data->SIGIN_BOARD0_SATMCU0_ENCODER1_POSITION = value;
}

void convert_sigin_board0_satmcu0_encoder2_position(data_t *data) {
    float value = data->VARIN32_ENCODER2_POSITION;
    float offset = *data->SIGIN_BOARD0_SATMCU0_ENCODER2_POSITION_OFFSET;
    float scale = *data->SIGIN_BOARD0_SATMCU0_ENCODER2_POSITION_SCALE;
    value = value + offset;
    value = value / scale;
    *data->SIGIN_BOARD0_SATMCU0_ENCODER2_POSITION_ABS = fabs(value);
    *data->SIGIN_BOARD0_SATMCU0_ENCODER2_POSITION_S32 = value;
    *data->SIGIN_BOARD0_SATMCU0_ENCODER2_POSITION_U32_ABS = fabs(value);
    *data->SIGIN_BOARD0_SATMCU0_ENCODER2_POSITION = value;
}

void convert_sigin_board0_satmcu0_encoder3_position(data_t *data) {
    float value = data->VARIN32_ENCODER3_POSITION;
    float offset = *data->SIGIN_BOARD0_SATMCU0_ENCODER3_POSITION_OFFSET;
    float scale = *data->SIGIN_BOARD0_SATMCU0_ENCODER3_POSITION_SCALE;
    value = value + offset;
    value = value / scale;
    *data->SIGIN_BOARD0_SATMCU0_ENCODER3_POSITION_ABS = fabs(value);
    *data->SIGIN_BOARD0_SATMCU0_ENCODER3_POSITION_S32 = value;
    *data->SIGIN_BOARD0_SATMCU0_ENCODER3_POSITION_U32_ABS = fabs(value);
    *data->SIGIN_BOARD0_SATMCU0_ENCODER3_POSITION = value;
}

void convert_sigin_board0_satmcu1_gpioin1_bit(data_t *data) {
    bool value = data->VARIN1_GPIOIN1_BIT;
    *data->SIGIN_BOARD0_SATMCU1_GPIOIN1_BIT = value;
    *data->SIGIN_BOARD0_SATMCU1_GPIOIN1_BIT_not = 1 - value;
}



// Generated by component_buffer_converter()
void convert_outputs(void) {
    // output loop: SIGOUT -> calc -> VAROUT -> txBuffer
    convert_varout32_stepdir0_velocity(data);
    convert_varout1_stepdir0_enable(data);
    convert_varout32_stepdir1_velocity(data);
    convert_varout1_stepdir1_enable(data);
    convert_varout32_stepdir2_velocity(data);
    convert_varout1_stepdir2_enable(data);
    convert_varout1_bitout0_bit(data);
    convert_varout1_bitout1_bit(data);
    convert_varout1_gpioout0_bit(data);
    convert_varout1_gpioout1_bit(data);
    convert_varout1_gpioout2_bit(data);
    convert_varout1_gpioout3_bit(data);
    convert_varout1_gpioout4_bit(data);
    convert_varout1_gpioout5_bit(data);
    convert_varout1_gpioout6_bit(data);
    convert_varout1_gpioout7_bit(data);
    convert_varout1_gpioout8_bit(data);
    convert_varout1_gpioout9_bit(data);
}

void convert_inputs(void) {
    // input: rxBuffer -> VAROUT -> calc -> SIGOUT
    convert_sigin_board0_stepdir0_position(data);
    convert_sigin_board0_stepdir1_position(data);
    convert_sigin_board0_bitin0_bit(data);
    convert_sigin_board0_stepdir2_position(data);
    convert_sigin_board0_bitin1_bit(data);
    convert_sigin_board0_bitin2_bit(data);
    convert_sigin_board0_bitin3_bit(data);
    convert_sigin_board0_bitin4_bit(data);
    convert_sigin_board0_bitin5_bit(data);
    convert_sigin_board0_uartsub1_timeout(data);
    convert_sigin_board0_uartsub0_timeout(data);
    convert_sigin_board0_satmcu0_gpioin0_bit(data);
    convert_sigin_board0_satmcu0_encoder0_position(data);
    convert_sigin_board0_satmcu0_encoder1_position(data);
    convert_sigin_board0_satmcu0_encoder2_position(data);
    convert_sigin_board0_satmcu0_encoder3_position(data);
    convert_sigin_board0_satmcu1_gpioin1_bit(data);
}

// Generated by component_buffer()
void write_txbuffer(uint8_t *txBuffer) {
    // PC -> FPGA (143 + 161)
    int i = 0;
    for (i = 0; i < BUFFER_SIZE_TX; i++) {
        txBuffer[i] = 0;
    }
    // raw vars to txBuffer
    txBuffer[0] = 0x74;  // 304
    txBuffer[1] = 0x69;  // 296
    txBuffer[2] = 0x72;  // 288
    txBuffer[3] = 0x77;  // 280
    memcpy(&txBuffer[4], &data->VAROUT32_STEPDIR0_VELOCITY, 4);  // 272
    memcpy(&txBuffer[8], &data->VAROUT32_STEPDIR1_VELOCITY, 4);  // 240
    memcpy(&txBuffer[12], &data->VAROUT32_STEPDIR2_VELOCITY, 4);  // 208
    txBuffer[16] |= (data->VAROUT1_STEPDIR0_ENABLE<<7);  // 176
    txBuffer[16] |= (data->VAROUT1_STEPDIR1_ENABLE<<6);  // 175
    txBuffer[16] |= (data->VAROUT1_STEPDIR2_ENABLE<<5);  // 174
    txBuffer[16] |= (data->VAROUT1_BITOUT0_BIT<<4);  // 173
    txBuffer[16] |= (data->VAROUT1_BITOUT1_BIT<<3);  // 172
    txBuffer[16] |= (data->VAROUT1_GPIOOUT0_BIT<<2);  // 171
    txBuffer[16] |= (data->VAROUT1_GPIOOUT1_BIT<<1);  // 170
    txBuffer[16] |= (data->VAROUT1_GPIOOUT2_BIT<<0);  // 169
    txBuffer[17] |= (data->VAROUT1_GPIOOUT3_BIT<<7);  // 168
    txBuffer[17] |= (data->VAROUT1_GPIOOUT4_BIT<<6);  // 167
    txBuffer[17] |= (data->VAROUT1_GPIOOUT5_BIT<<5);  // 166
    txBuffer[17] |= (data->VAROUT1_GPIOOUT6_BIT<<4);  // 165
    txBuffer[17] |= (data->VAROUT1_GPIOOUT7_BIT<<3);  // 164
    txBuffer[17] |= (data->VAROUT1_GPIOOUT8_BIT<<2);  // 163
    txBuffer[17] |= (data->VAROUT1_GPIOOUT9_BIT<<1);  // 162
    // FILL: 161
}

void read_rxbuffer(uint8_t *rxBuffer) {
    // FPGA -> PC (298 + 6)
    // memcpy(&header, &rxBuffer[0], 4) // 304;
    memcpy(&fpga_timestamp, &rxBuffer[4], 4);  // 272
    memcpy(&data->VARIN32_STEPDIR0_POSITION, &rxBuffer[8], 4);  // 240
    memcpy(&data->VARIN32_STEPDIR1_POSITION, &rxBuffer[12], 4);  // 208
    memcpy(&data->VARIN32_STEPDIR2_POSITION, &rxBuffer[16], 4);  // 176
    memcpy(&data->VARIN32_ENCODER0_POSITION, &rxBuffer[20], 4);  // 144
    memcpy(&data->VARIN32_ENCODER1_POSITION, &rxBuffer[24], 4);  // 112
    memcpy(&data->VARIN32_ENCODER2_POSITION, &rxBuffer[28], 4);  // 80
    memcpy(&data->VARIN32_ENCODER3_POSITION, &rxBuffer[32], 4);  // 48
    data->VARIN1_BITIN0_BIT = (rxBuffer[36] & (1<<7));  // 16
    data->VARIN1_BITIN1_BIT = (rxBuffer[36] & (1<<6));  // 15
    data->VARIN1_BITIN2_BIT = (rxBuffer[36] & (1<<5));  // 14
    data->VARIN1_BITIN3_BIT = (rxBuffer[36] & (1<<4));  // 13
    data->VARIN1_BITIN4_BIT = (rxBuffer[36] & (1<<3));  // 12
    data->VARIN1_BITIN5_BIT = (rxBuffer[36] & (1<<2));  // 11
    data->VARIN1_UARTSUB1_TIMEOUT = (rxBuffer[36] & (1<<1));  // 10
    data->VARIN1_UARTSUB0_TIMEOUT = (rxBuffer[36] & (1<<0));  // 9
    data->VARIN1_GPIOIN0_BIT = (rxBuffer[37] & (1<<7));  // 8
    data->VARIN1_GPIOIN1_BIT = (rxBuffer[37] & (1<<6));  // 7
    // FILL: 6
}

void rio_readwrite(__attribute__((unused)) void *inst, __attribute__((unused)) int64_t period) {
    int ret = 0;
    uint8_t i = 0;
    uint8_t rxBuffer[BUFFER_SIZE_RX * 2];
    uint8_t txBuffer[BUFFER_SIZE_TX * 2];
    int64_t stamp_new = rtapi_get_time();
    float timestamp = (float)fpga_timestamp / (float)OSC_CLOCK;
    *data->duration = timestamp - fpga_stamp_last;
    fpga_stamp_last = timestamp;
    stamp_last = stamp_new;
    if (*data->sys_enable == 1 || *data->sys_enable_request == 1) {
        pkg_counter += 1;
        convert_outputs();
        if (*data->sys_simulation != 1) {
            write_txbuffer(txBuffer);
#ifdef UDP_ASYNC
            ret = udp_rx(rxBuffer, BUFFER_SIZE_RX, 1);
            udp_tx(txBuffer, BUFFER_SIZE_TX);
#else
            udp_tx(txBuffer, BUFFER_SIZE_TX);
            ret = udp_rx(rxBuffer, BUFFER_SIZE_RX, 0);
#endif
            if (ret == BUFFER_SIZE_RX && rxBuffer[0] == 97 && rxBuffer[1] == 116 && rxBuffer[2] == 97 && rxBuffer[3] == 100) {
                if (err_counter > 0) {
                    err_counter = 0;
                    printf("recovered..\n");
                }
                read_rxbuffer(rxBuffer);
                convert_inputs();
                *data->sys_status = 1;
            } else {
                err_counter += 1;
                err_total += 1;
                if (err_counter < 5) {
                    if (ret != BUFFER_SIZE_RX) {
                        printf("%li: wrong data size (len %i/%i err %i/3) - (%i %i - %0.4f %%)", stamp_new, ret, BUFFER_SIZE_RX, err_counter, err_total, pkg_counter, (float)err_total * 100.0 / (float)pkg_counter);
                    } else {
                        printf("%li: wrong header (%i/3) - (%i %i - %0.4f %%):", stamp_new, err_counter, err_total, pkg_counter, (float)err_total * 100.0 / (float)pkg_counter);
                    }
                    for (i = 0; i < ret; i++) {
                        printf("%d ", rxBuffer[i]);
                    }
                    printf("\n");
                    if (err_counter > 3) {
                        printf("too many errors..\n");
                        *data->sys_status = 0;
                        *data->sys_error = 1;
                    }
                }
            }
        } else {
            convert_inputs();
            *data->sys_status = 1;
        }
    } else {
        *data->sys_status = 0;
        *data->sys_error = 0;
    }
}

