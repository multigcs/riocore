// Copyright [2025] <o.dippel@gmx.de>
// Generated by rio-generator

#include <rtapi.h>
#include <rtapi_app.h>
#include <hal.h>
#include <unistd.h>
#include <stdlib.h>
#include <stdbool.h>
#include <stdio.h>
#include <string.h>
#include <math.h>
#include <sys/mman.h>
#include <errno.h>
#include <fcntl.h>
#include <termios.h>

MODULE_AUTHOR("Oliver Dippel");
MODULE_DESCRIPTION("Driver for RIO FPGA boards");
MODULE_LICENSE("GPL v2");

#define MODNAME "riocomp-board0"
#define PREFIX "board0"
#define JOINTS 3
#define BUFFER_SIZE_RX 28
#define BUFFER_SIZE_TX 20
#define OSC_CLOCK 27000000
#define UDP_IP "192.168.11.201"
#define SRC_PORT 2391
#define DST_PORT 2390
#define UDP_ASYNC 1

static int comp_id;
static const char *modname = MODNAME;
static const char *prefix = PREFIX;

uint32_t pkg_counter = 0;
uint32_t err_total = 0;
uint32_t err_counter = 0;

int64_t stamp_last = 0;
float fpga_stamp_last = 0;
uint32_t fpga_timestamp = 0;
int64_t servo_period = 1000000000;

void rio_readwrite(void *inst, int64_t period);
int error_handler(int retval);

#define MAX(a, b) (((a) > (b))?(a):(b))

typedef struct {
    // hal variables
    hal_bit_t   *sys_enable;
    hal_bit_t   *sys_enable_request;
    hal_bit_t   *sys_status;
    hal_bit_t   *sys_error;
    hal_bit_t   *sys_simulation;
    hal_u32_t   *fpga_timestamp;
    hal_float_t *duration;
    float MULTIPLEXER_INPUT_VALUE;
    uint8_t MULTIPLEXER_INPUT_ID;
    hal_bit_t   *SIGIN_BOARD0_BITIN0_BIT;
    hal_bit_t   *SIGIN_BOARD0_BITIN0_BIT_not;
    hal_bit_t   *SIGIN_BOARD0_BITIN1_BIT;
    hal_bit_t   *SIGIN_BOARD0_BITIN1_BIT_not;
    hal_bit_t   *SIGIN_BOARD0_BITIN2_BIT;
    hal_bit_t   *SIGIN_BOARD0_BITIN2_BIT_not;
    hal_float_t *SIGOUT_BOARD0_STEPDIR0_VELOCITY;
    hal_float_t *SIGOUT_BOARD0_STEPDIR0_VELOCITY_SCALE;
    hal_float_t *SIGOUT_BOARD0_STEPDIR0_VELOCITY_OFFSET;
    hal_float_t *SIGIN_BOARD0_STEPDIR0_POSITION;
    hal_float_t *SIGIN_BOARD0_STEPDIR0_POSITION_ABS;
    hal_s32_t *SIGIN_BOARD0_STEPDIR0_POSITION_S32;
    hal_u32_t *SIGIN_BOARD0_STEPDIR0_POSITION_U32_ABS;
    hal_float_t *SIGIN_BOARD0_STEPDIR0_POSITION_SCALE;
    hal_float_t *SIGIN_BOARD0_STEPDIR0_POSITION_OFFSET;
    hal_bit_t   *SIGOUT_BOARD0_STEPDIR0_ENABLE;
    hal_float_t *SIGOUT_BOARD0_STEPDIR1_VELOCITY;
    hal_float_t *SIGOUT_BOARD0_STEPDIR1_VELOCITY_SCALE;
    hal_float_t *SIGOUT_BOARD0_STEPDIR1_VELOCITY_OFFSET;
    hal_float_t *SIGIN_BOARD0_STEPDIR1_POSITION;
    hal_float_t *SIGIN_BOARD0_STEPDIR1_POSITION_ABS;
    hal_s32_t *SIGIN_BOARD0_STEPDIR1_POSITION_S32;
    hal_u32_t *SIGIN_BOARD0_STEPDIR1_POSITION_U32_ABS;
    hal_float_t *SIGIN_BOARD0_STEPDIR1_POSITION_SCALE;
    hal_float_t *SIGIN_BOARD0_STEPDIR1_POSITION_OFFSET;
    hal_bit_t   *SIGOUT_BOARD0_STEPDIR1_ENABLE;
    hal_float_t *SIGOUT_BOARD0_STEPDIR2_VELOCITY;
    hal_float_t *SIGOUT_BOARD0_STEPDIR2_VELOCITY_SCALE;
    hal_float_t *SIGOUT_BOARD0_STEPDIR2_VELOCITY_OFFSET;
    hal_float_t *SIGIN_BOARD0_STEPDIR2_POSITION;
    hal_float_t *SIGIN_BOARD0_STEPDIR2_POSITION_ABS;
    hal_s32_t *SIGIN_BOARD0_STEPDIR2_POSITION_S32;
    hal_u32_t *SIGIN_BOARD0_STEPDIR2_POSITION_U32_ABS;
    hal_float_t *SIGIN_BOARD0_STEPDIR2_POSITION_SCALE;
    hal_float_t *SIGIN_BOARD0_STEPDIR2_POSITION_OFFSET;
    hal_bit_t   *SIGOUT_BOARD0_STEPDIR2_ENABLE;
    hal_bit_t   *SIGIN_BOARD0_BITIN3_BIT;
    hal_bit_t   *SIGIN_BOARD0_BITIN3_BIT_not;
    hal_bit_t   *SIGIN_BOARD0_BITIN4_BIT;
    hal_bit_t   *SIGIN_BOARD0_BITIN4_BIT_not;
    hal_bit_t   *SIGIN_BOARD0_BITIN5_BIT;
    hal_bit_t   *SIGIN_BOARD0_BITIN5_BIT_not;
    hal_float_t *SIGOUT_BOARD0_PWMOUT0_DTY;
    hal_float_t *SIGOUT_BOARD0_PWMOUT0_DTY_SCALE;
    hal_float_t *SIGOUT_BOARD0_PWMOUT0_DTY_OFFSET;
    hal_bit_t   *SIGOUT_BOARD0_PWMOUT0_ENABLE;
    hal_bit_t   *SIGOUT_BOARD0_BITOUT0_BIT;
    hal_bit_t   *SIGOUT_BOARD0_BITOUT1_BIT;
    hal_bit_t   *SIGIN_BOARD0_BITIN6_BIT;
    hal_bit_t   *SIGIN_BOARD0_BITIN6_BIT_not;
    hal_bit_t   *SIGIN_BOARD0_BITIN7_BIT;
    hal_bit_t   *SIGIN_BOARD0_BITIN7_BIT_not;
    hal_float_t *SIGIN_BOARD0_SATMCU0_FEED_POSITION;
    hal_float_t *SIGIN_BOARD0_SATMCU0_FEED_POSITION_ABS;
    hal_s32_t *SIGIN_BOARD0_SATMCU0_FEED_POSITION_S32;
    hal_u32_t *SIGIN_BOARD0_SATMCU0_FEED_POSITION_U32_ABS;
    hal_float_t *SIGIN_BOARD0_SATMCU0_FEED_POSITION_SCALE;
    hal_float_t *SIGIN_BOARD0_SATMCU0_FEED_POSITION_OFFSET;
    hal_bit_t   *SIGIN_BOARD0_SATUART0_TIMEOUT;
    hal_bit_t   *SIGIN_BOARD0_SATUART0_TIMEOUT_not;
    hal_float_t *SIGIN_BOARD0_SATMCU0_SPINDLE_POSITION;
    hal_float_t *SIGIN_BOARD0_SATMCU0_SPINDLE_POSITION_ABS;
    hal_s32_t *SIGIN_BOARD0_SATMCU0_SPINDLE_POSITION_S32;
    hal_u32_t *SIGIN_BOARD0_SATMCU0_SPINDLE_POSITION_U32_ABS;
    hal_float_t *SIGIN_BOARD0_SATMCU0_SPINDLE_POSITION_SCALE;
    hal_float_t *SIGIN_BOARD0_SATMCU0_SPINDLE_POSITION_OFFSET;
    hal_float_t *SIGIN_BOARD0_SATMCU0_RAPID_POSITION;
    hal_float_t *SIGIN_BOARD0_SATMCU0_RAPID_POSITION_ABS;
    hal_s32_t *SIGIN_BOARD0_SATMCU0_RAPID_POSITION_S32;
    hal_u32_t *SIGIN_BOARD0_SATMCU0_RAPID_POSITION_U32_ABS;
    hal_float_t *SIGIN_BOARD0_SATMCU0_RAPID_POSITION_SCALE;
    hal_float_t *SIGIN_BOARD0_SATMCU0_RAPID_POSITION_OFFSET;
    hal_float_t *SIGIN_BOARD0_SATMCU0_JOGWHEEL_POSITION;
    hal_float_t *SIGIN_BOARD0_SATMCU0_JOGWHEEL_POSITION_ABS;
    hal_s32_t *SIGIN_BOARD0_SATMCU0_JOGWHEEL_POSITION_S32;
    hal_u32_t *SIGIN_BOARD0_SATMCU0_JOGWHEEL_POSITION_U32_ABS;
    hal_float_t *SIGIN_BOARD0_SATMCU0_JOGWHEEL_POSITION_SCALE;
    hal_float_t *SIGIN_BOARD0_SATMCU0_JOGWHEEL_POSITION_OFFSET;
    hal_bit_t   *SIGIN_BOARD0_SATMCU0_MPGESTOP_BIT;
    hal_bit_t   *SIGIN_BOARD0_SATMCU0_MPGESTOP_BIT_not;
    hal_bit_t   *SIGIN_BOARD0_SATMCU0_SCALE0_BIT;
    hal_bit_t   *SIGIN_BOARD0_SATMCU0_SCALE0_BIT_not;
    hal_bit_t   *SIGOUT_BOARD0_SATMCU0_LEDSCALE0_BIT;
    hal_bit_t   *SIGIN_BOARD0_SATMCU0_SCALE1_BIT;
    hal_bit_t   *SIGIN_BOARD0_SATMCU0_SCALE1_BIT_not;
    hal_bit_t   *SIGIN_BOARD0_SATMCU0_SCALE2_BIT;
    hal_bit_t   *SIGIN_BOARD0_SATMCU0_SCALE2_BIT_not;
    hal_bit_t   *SIGIN_BOARD0_SATMCU0_SELECTX_BIT;
    hal_bit_t   *SIGIN_BOARD0_SATMCU0_SELECTX_BIT_not;
    hal_bit_t   *SIGIN_BOARD0_SATMCU0_SELECTY_BIT;
    hal_bit_t   *SIGIN_BOARD0_SATMCU0_SELECTY_BIT_not;
    hal_bit_t   *SIGOUT_BOARD0_SATMCU0_LEDSCALE1_BIT;
    hal_bit_t   *SIGOUT_BOARD0_SATMCU0_LEDSCALE2_BIT;
    hal_bit_t   *SIGOUT_BOARD0_SATMCU0_SELECTEDX_BIT;
    hal_bit_t   *SIGOUT_BOARD0_SATMCU0_SELECTEDY_BIT;
    hal_bit_t   *SIGOUT_BOARD0_SATMCU0_SELECTEDZ_BIT;
    hal_bit_t   *SIGIN_BOARD0_SATMCU0_SELECTZ_BIT;
    hal_bit_t   *SIGIN_BOARD0_SATMCU0_SELECTZ_BIT_not;
    hal_bit_t   *SIGIN_BOARD0_SATMCU0_LBUTTON_BIT;
    hal_bit_t   *SIGIN_BOARD0_SATMCU0_LBUTTON_BIT_not;
    hal_bit_t   *SIGIN_BOARD0_SATMCU0_LBUTTON_BIT_SHORT;
    hal_bit_t   *SIGIN_BOARD0_SATMCU0_LBUTTON_BIT_SHORT_not;
    hal_bit_t   *SIGIN_BOARD0_SATMCU0_LBUTTON_BIT_LONG1;
    hal_bit_t   *SIGIN_BOARD0_SATMCU0_LBUTTON_BIT_LONG1_not;
    hal_bit_t   *SIGIN_BOARD0_SATMCU0_LBUTTON_BIT_LONG2;
    hal_bit_t   *SIGIN_BOARD0_SATMCU0_LBUTTON_BIT_LONG2_not;
    hal_bit_t   *SIGIN_BOARD0_SATMCU0_CBUTTON_BIT;
    hal_bit_t   *SIGIN_BOARD0_SATMCU0_CBUTTON_BIT_not;
    hal_bit_t   *SIGIN_BOARD0_SATMCU0_RBUTTON_BIT;
    hal_bit_t   *SIGIN_BOARD0_SATMCU0_RBUTTON_BIT_not;
    hal_bit_t   *SIGIN_BOARD0_SATMCU0_RBUTTON_BIT_SHORT;
    hal_bit_t   *SIGIN_BOARD0_SATMCU0_RBUTTON_BIT_SHORT_not;
    hal_bit_t   *SIGIN_BOARD0_SATMCU0_RBUTTON_BIT_LONG1;
    hal_bit_t   *SIGIN_BOARD0_SATMCU0_RBUTTON_BIT_LONG1_not;
    hal_bit_t   *SIGIN_BOARD0_SATMCU0_RBUTTON_BIT_LONG2;
    hal_bit_t   *SIGIN_BOARD0_SATMCU0_RBUTTON_BIT_LONG2_not;
    // raw variables
    int32_t VAROUT32_STEPDIR0_VELOCITY;
    int32_t VARIN32_STEPDIR0_POSITION;
    int32_t VAROUT32_STEPDIR1_VELOCITY;
    int32_t VARIN32_STEPDIR1_POSITION;
    int32_t VAROUT32_STEPDIR2_VELOCITY;
    int32_t VARIN32_STEPDIR2_POSITION;
    int32_t VARIN32_FEED_POSITION;
    int32_t VARIN32_SPINDLE_POSITION;
    int32_t VARIN32_RAPID_POSITION;
    int32_t VARIN32_JOGWHEEL_POSITION;
    int16_t VAROUT16_PWMOUT0_DTY;
    bool VARIN1_BITIN0_BIT;
    bool VARIN1_BITIN1_BIT;
    bool VARIN1_BITIN2_BIT;
    bool VAROUT1_STEPDIR0_ENABLE;
    bool VAROUT1_STEPDIR1_ENABLE;
    bool VAROUT1_STEPDIR2_ENABLE;
    bool VARIN1_BITIN3_BIT;
    bool VARIN1_BITIN4_BIT;
    bool VARIN1_BITIN5_BIT;
    bool VAROUT1_PWMOUT0_ENABLE;
    bool VAROUT1_BITOUT0_BIT;
    bool VAROUT1_BITOUT1_BIT;
    bool VARIN1_BITIN6_BIT;
    bool VARIN1_BITIN7_BIT;
    bool VARIN1_SATUART0_TIMEOUT;
    bool VARIN1_MPGESTOP_BIT;
    bool VARIN1_SCALE0_BIT;
    bool VAROUT1_LEDSCALE0_BIT;
    bool VARIN1_SCALE1_BIT;
    bool VARIN1_SCALE2_BIT;
    bool VARIN1_SELECTX_BIT;
    bool VARIN1_SELECTY_BIT;
    bool VAROUT1_LEDSCALE1_BIT;
    bool VAROUT1_LEDSCALE2_BIT;
    bool VAROUT1_SELECTEDX_BIT;
    bool VAROUT1_SELECTEDY_BIT;
    bool VAROUT1_SELECTEDZ_BIT;
    bool VARIN1_SELECTZ_BIT;
    bool VARIN1_LBUTTON_BIT;
    bool VARIN1_CBUTTON_BIT;
    bool VARIN1_RBUTTON_BIT;
} data_t;
static data_t *data;

data_t *register_signals(void) {
    int retval = 0;
    data->VAROUT32_STEPDIR0_VELOCITY = 0;
    data->VARIN32_STEPDIR0_POSITION = 0;
    data->VAROUT32_STEPDIR1_VELOCITY = 0;
    data->VARIN32_STEPDIR1_POSITION = 0;
    data->VAROUT32_STEPDIR2_VELOCITY = 0;
    data->VARIN32_STEPDIR2_POSITION = 0;
    data->VARIN32_FEED_POSITION = 0;
    data->VARIN32_SPINDLE_POSITION = 0;
    data->VARIN32_RAPID_POSITION = 0;
    data->VARIN32_JOGWHEEL_POSITION = 0;
    data->VAROUT16_PWMOUT0_DTY = 0;
    data->VARIN1_BITIN0_BIT = 0;
    data->VARIN1_BITIN1_BIT = 0;
    data->VARIN1_BITIN2_BIT = 0;
    data->VAROUT1_STEPDIR0_ENABLE = 0;
    data->VAROUT1_STEPDIR1_ENABLE = 0;
    data->VAROUT1_STEPDIR2_ENABLE = 0;
    data->VARIN1_BITIN3_BIT = 0;
    data->VARIN1_BITIN4_BIT = 0;
    data->VARIN1_BITIN5_BIT = 0;
    data->VAROUT1_PWMOUT0_ENABLE = 0;
    data->VAROUT1_BITOUT0_BIT = 0;
    data->VAROUT1_BITOUT1_BIT = 0;
    data->VARIN1_BITIN6_BIT = 0;
    data->VARIN1_BITIN7_BIT = 0;
    data->VARIN1_SATUART0_TIMEOUT = 0;
    data->VARIN1_MPGESTOP_BIT = 0;
    data->VARIN1_SCALE0_BIT = 0;
    data->VAROUT1_LEDSCALE0_BIT = 0;
    data->VARIN1_SCALE1_BIT = 0;
    data->VARIN1_SCALE2_BIT = 0;
    data->VARIN1_SELECTX_BIT = 0;
    data->VARIN1_SELECTY_BIT = 0;
    data->VAROUT1_LEDSCALE1_BIT = 0;
    data->VAROUT1_LEDSCALE2_BIT = 0;
    data->VAROUT1_SELECTEDX_BIT = 0;
    data->VAROUT1_SELECTEDY_BIT = 0;
    data->VAROUT1_SELECTEDZ_BIT = 0;
    data->VARIN1_SELECTZ_BIT = 0;
    data->VARIN1_LBUTTON_BIT = 0;
    data->VARIN1_CBUTTON_BIT = 0;
    data->VARIN1_RBUTTON_BIT = 0;

    if ((retval = hal_pin_bit_newf(HAL_OUT, &(data->sys_error), comp_id, "board0.sys-error")) != 0) error_handler(retval);
    if ((retval = hal_pin_bit_newf(HAL_OUT, &(data->sys_status), comp_id, "board0.sys-status")) != 0) error_handler(retval);
    if ((retval = hal_pin_bit_newf(HAL_IN, &(data->sys_enable), comp_id, "board0.sys-enable")) != 0) error_handler(retval);
    if ((retval = hal_pin_bit_newf(HAL_IN, &(data->sys_enable_request), comp_id, "board0.sys-enable-request")) != 0) error_handler(retval);
    if ((retval = hal_pin_bit_newf(HAL_IN, &(data->sys_simulation), comp_id, "board0.sys-simulation")) != 0) error_handler(retval);
    *data->sys_simulation = 0;
    if ((retval = hal_pin_float_newf(HAL_OUT, &(data->duration), comp_id, "board0.duration")) != 0) error_handler(retval);
    *data->duration = rtapi_get_time();
    if ((retval = hal_pin_bit_newf(HAL_OUT, &(data->SIGIN_BOARD0_BITIN0_BIT), comp_id, "board0.bitin0.bit")) != 0) error_handler(retval);
    *data->SIGIN_BOARD0_BITIN0_BIT = 0;
    if ((retval = hal_pin_bit_newf(HAL_OUT, &(data->SIGIN_BOARD0_BITIN0_BIT_not), comp_id, "board0.bitin0.bit-not")) != 0) error_handler(retval);
    *data->SIGIN_BOARD0_BITIN0_BIT_not = 1 - *data->SIGIN_BOARD0_BITIN0_BIT;
    if ((retval = hal_pin_bit_newf(HAL_OUT, &(data->SIGIN_BOARD0_BITIN1_BIT), comp_id, "board0.bitin1.bit")) != 0) error_handler(retval);
    *data->SIGIN_BOARD0_BITIN1_BIT = 0;
    if ((retval = hal_pin_bit_newf(HAL_OUT, &(data->SIGIN_BOARD0_BITIN1_BIT_not), comp_id, "board0.bitin1.bit-not")) != 0) error_handler(retval);
    *data->SIGIN_BOARD0_BITIN1_BIT_not = 1 - *data->SIGIN_BOARD0_BITIN1_BIT;
    if ((retval = hal_pin_bit_newf(HAL_OUT, &(data->SIGIN_BOARD0_BITIN2_BIT), comp_id, "board0.bitin2.bit")) != 0) error_handler(retval);
    *data->SIGIN_BOARD0_BITIN2_BIT = 0;
    if ((retval = hal_pin_bit_newf(HAL_OUT, &(data->SIGIN_BOARD0_BITIN2_BIT_not), comp_id, "board0.bitin2.bit-not")) != 0) error_handler(retval);
    *data->SIGIN_BOARD0_BITIN2_BIT_not = 1 - *data->SIGIN_BOARD0_BITIN2_BIT;
    if ((retval = hal_pin_float_newf(HAL_IN, &(data->SIGOUT_BOARD0_STEPDIR0_VELOCITY_SCALE), comp_id, "board0.stepdir0.velocity-scale")) != 0) error_handler(retval);
    *data->SIGOUT_BOARD0_STEPDIR0_VELOCITY_SCALE = 1.0;
    if ((retval = hal_pin_float_newf(HAL_IN, &(data->SIGOUT_BOARD0_STEPDIR0_VELOCITY_OFFSET), comp_id, "board0.stepdir0.velocity-offset")) != 0) error_handler(retval);
    *data->SIGOUT_BOARD0_STEPDIR0_VELOCITY_OFFSET = 0.0;
    if ((retval = hal_pin_float_newf(HAL_IN, &(data->SIGOUT_BOARD0_STEPDIR0_VELOCITY), comp_id, "board0.stepdir0.velocity")) != 0) error_handler(retval);
    *data->SIGOUT_BOARD0_STEPDIR0_VELOCITY = 0;
    if ((retval = hal_pin_float_newf(HAL_IN, &(data->SIGIN_BOARD0_STEPDIR0_POSITION_SCALE), comp_id, "board0.stepdir0.position-scale")) != 0) error_handler(retval);
    *data->SIGIN_BOARD0_STEPDIR0_POSITION_SCALE = 1.0;
    if ((retval = hal_pin_float_newf(HAL_IN, &(data->SIGIN_BOARD0_STEPDIR0_POSITION_OFFSET), comp_id, "board0.stepdir0.position-offset")) != 0) error_handler(retval);
    *data->SIGIN_BOARD0_STEPDIR0_POSITION_OFFSET = 0.0;
    if ((retval = hal_pin_float_newf(HAL_OUT, &(data->SIGIN_BOARD0_STEPDIR0_POSITION), comp_id, "board0.stepdir0.position")) != 0) error_handler(retval);
    *data->SIGIN_BOARD0_STEPDIR0_POSITION = 0;
    if ((retval = hal_pin_float_newf(HAL_OUT, &(data->SIGIN_BOARD0_STEPDIR0_POSITION_ABS), comp_id, "board0.stepdir0.position-abs")) != 0) error_handler(retval);
    *data->SIGIN_BOARD0_STEPDIR0_POSITION_ABS = 0;
    if ((retval = hal_pin_s32_newf(HAL_OUT, &(data->SIGIN_BOARD0_STEPDIR0_POSITION_S32), comp_id, "board0.stepdir0.position-s32")) != 0) error_handler(retval);
    *data->SIGIN_BOARD0_STEPDIR0_POSITION_S32 = 0;
    if ((retval = hal_pin_u32_newf(HAL_OUT, &(data->SIGIN_BOARD0_STEPDIR0_POSITION_U32_ABS), comp_id, "board0.stepdir0.position-u32-abs")) != 0) error_handler(retval);
    *data->SIGIN_BOARD0_STEPDIR0_POSITION_U32_ABS = 0;
    if ((retval = hal_pin_bit_newf(HAL_IN, &(data->SIGOUT_BOARD0_STEPDIR0_ENABLE), comp_id, "board0.stepdir0.enable")) != 0) error_handler(retval);
    *data->SIGOUT_BOARD0_STEPDIR0_ENABLE = 0;
    if ((retval = hal_pin_float_newf(HAL_IN, &(data->SIGOUT_BOARD0_STEPDIR1_VELOCITY_SCALE), comp_id, "board0.stepdir1.velocity-scale")) != 0) error_handler(retval);
    *data->SIGOUT_BOARD0_STEPDIR1_VELOCITY_SCALE = 1.0;
    if ((retval = hal_pin_float_newf(HAL_IN, &(data->SIGOUT_BOARD0_STEPDIR1_VELOCITY_OFFSET), comp_id, "board0.stepdir1.velocity-offset")) != 0) error_handler(retval);
    *data->SIGOUT_BOARD0_STEPDIR1_VELOCITY_OFFSET = 0.0;
    if ((retval = hal_pin_float_newf(HAL_IN, &(data->SIGOUT_BOARD0_STEPDIR1_VELOCITY), comp_id, "board0.stepdir1.velocity")) != 0) error_handler(retval);
    *data->SIGOUT_BOARD0_STEPDIR1_VELOCITY = 0;
    if ((retval = hal_pin_float_newf(HAL_IN, &(data->SIGIN_BOARD0_STEPDIR1_POSITION_SCALE), comp_id, "board0.stepdir1.position-scale")) != 0) error_handler(retval);
    *data->SIGIN_BOARD0_STEPDIR1_POSITION_SCALE = 1.0;
    if ((retval = hal_pin_float_newf(HAL_IN, &(data->SIGIN_BOARD0_STEPDIR1_POSITION_OFFSET), comp_id, "board0.stepdir1.position-offset")) != 0) error_handler(retval);
    *data->SIGIN_BOARD0_STEPDIR1_POSITION_OFFSET = 0.0;
    if ((retval = hal_pin_float_newf(HAL_OUT, &(data->SIGIN_BOARD0_STEPDIR1_POSITION), comp_id, "board0.stepdir1.position")) != 0) error_handler(retval);
    *data->SIGIN_BOARD0_STEPDIR1_POSITION = 0;
    if ((retval = hal_pin_float_newf(HAL_OUT, &(data->SIGIN_BOARD0_STEPDIR1_POSITION_ABS), comp_id, "board0.stepdir1.position-abs")) != 0) error_handler(retval);
    *data->SIGIN_BOARD0_STEPDIR1_POSITION_ABS = 0;
    if ((retval = hal_pin_s32_newf(HAL_OUT, &(data->SIGIN_BOARD0_STEPDIR1_POSITION_S32), comp_id, "board0.stepdir1.position-s32")) != 0) error_handler(retval);
    *data->SIGIN_BOARD0_STEPDIR1_POSITION_S32 = 0;
    if ((retval = hal_pin_u32_newf(HAL_OUT, &(data->SIGIN_BOARD0_STEPDIR1_POSITION_U32_ABS), comp_id, "board0.stepdir1.position-u32-abs")) != 0) error_handler(retval);
    *data->SIGIN_BOARD0_STEPDIR1_POSITION_U32_ABS = 0;
    if ((retval = hal_pin_bit_newf(HAL_IN, &(data->SIGOUT_BOARD0_STEPDIR1_ENABLE), comp_id, "board0.stepdir1.enable")) != 0) error_handler(retval);
    *data->SIGOUT_BOARD0_STEPDIR1_ENABLE = 0;
    if ((retval = hal_pin_float_newf(HAL_IN, &(data->SIGOUT_BOARD0_STEPDIR2_VELOCITY_SCALE), comp_id, "board0.stepdir2.velocity-scale")) != 0) error_handler(retval);
    *data->SIGOUT_BOARD0_STEPDIR2_VELOCITY_SCALE = 1.0;
    if ((retval = hal_pin_float_newf(HAL_IN, &(data->SIGOUT_BOARD0_STEPDIR2_VELOCITY_OFFSET), comp_id, "board0.stepdir2.velocity-offset")) != 0) error_handler(retval);
    *data->SIGOUT_BOARD0_STEPDIR2_VELOCITY_OFFSET = 0.0;
    if ((retval = hal_pin_float_newf(HAL_IN, &(data->SIGOUT_BOARD0_STEPDIR2_VELOCITY), comp_id, "board0.stepdir2.velocity")) != 0) error_handler(retval);
    *data->SIGOUT_BOARD0_STEPDIR2_VELOCITY = 0;
    if ((retval = hal_pin_float_newf(HAL_IN, &(data->SIGIN_BOARD0_STEPDIR2_POSITION_SCALE), comp_id, "board0.stepdir2.position-scale")) != 0) error_handler(retval);
    *data->SIGIN_BOARD0_STEPDIR2_POSITION_SCALE = 1.0;
    if ((retval = hal_pin_float_newf(HAL_IN, &(data->SIGIN_BOARD0_STEPDIR2_POSITION_OFFSET), comp_id, "board0.stepdir2.position-offset")) != 0) error_handler(retval);
    *data->SIGIN_BOARD0_STEPDIR2_POSITION_OFFSET = 0.0;
    if ((retval = hal_pin_float_newf(HAL_OUT, &(data->SIGIN_BOARD0_STEPDIR2_POSITION), comp_id, "board0.stepdir2.position")) != 0) error_handler(retval);
    *data->SIGIN_BOARD0_STEPDIR2_POSITION = 0;
    if ((retval = hal_pin_float_newf(HAL_OUT, &(data->SIGIN_BOARD0_STEPDIR2_POSITION_ABS), comp_id, "board0.stepdir2.position-abs")) != 0) error_handler(retval);
    *data->SIGIN_BOARD0_STEPDIR2_POSITION_ABS = 0;
    if ((retval = hal_pin_s32_newf(HAL_OUT, &(data->SIGIN_BOARD0_STEPDIR2_POSITION_S32), comp_id, "board0.stepdir2.position-s32")) != 0) error_handler(retval);
    *data->SIGIN_BOARD0_STEPDIR2_POSITION_S32 = 0;
    if ((retval = hal_pin_u32_newf(HAL_OUT, &(data->SIGIN_BOARD0_STEPDIR2_POSITION_U32_ABS), comp_id, "board0.stepdir2.position-u32-abs")) != 0) error_handler(retval);
    *data->SIGIN_BOARD0_STEPDIR2_POSITION_U32_ABS = 0;
    if ((retval = hal_pin_bit_newf(HAL_IN, &(data->SIGOUT_BOARD0_STEPDIR2_ENABLE), comp_id, "board0.stepdir2.enable")) != 0) error_handler(retval);
    *data->SIGOUT_BOARD0_STEPDIR2_ENABLE = 0;
    if ((retval = hal_pin_bit_newf(HAL_OUT, &(data->SIGIN_BOARD0_BITIN3_BIT), comp_id, "board0.bitin3.bit")) != 0) error_handler(retval);
    *data->SIGIN_BOARD0_BITIN3_BIT = 0;
    if ((retval = hal_pin_bit_newf(HAL_OUT, &(data->SIGIN_BOARD0_BITIN3_BIT_not), comp_id, "board0.bitin3.bit-not")) != 0) error_handler(retval);
    *data->SIGIN_BOARD0_BITIN3_BIT_not = 1 - *data->SIGIN_BOARD0_BITIN3_BIT;
    if ((retval = hal_pin_bit_newf(HAL_OUT, &(data->SIGIN_BOARD0_BITIN4_BIT), comp_id, "board0.bitin4.bit")) != 0) error_handler(retval);
    *data->SIGIN_BOARD0_BITIN4_BIT = 0;
    if ((retval = hal_pin_bit_newf(HAL_OUT, &(data->SIGIN_BOARD0_BITIN4_BIT_not), comp_id, "board0.bitin4.bit-not")) != 0) error_handler(retval);
    *data->SIGIN_BOARD0_BITIN4_BIT_not = 1 - *data->SIGIN_BOARD0_BITIN4_BIT;
    if ((retval = hal_pin_bit_newf(HAL_OUT, &(data->SIGIN_BOARD0_BITIN5_BIT), comp_id, "board0.bitin5.bit")) != 0) error_handler(retval);
    *data->SIGIN_BOARD0_BITIN5_BIT = 0;
    if ((retval = hal_pin_bit_newf(HAL_OUT, &(data->SIGIN_BOARD0_BITIN5_BIT_not), comp_id, "board0.bitin5.bit-not")) != 0) error_handler(retval);
    *data->SIGIN_BOARD0_BITIN5_BIT_not = 1 - *data->SIGIN_BOARD0_BITIN5_BIT;
    if ((retval = hal_pin_float_newf(HAL_IN, &(data->SIGOUT_BOARD0_PWMOUT0_DTY_SCALE), comp_id, "board0.pwmout0.dty-scale")) != 0) error_handler(retval);
    *data->SIGOUT_BOARD0_PWMOUT0_DTY_SCALE = 1.0;
    if ((retval = hal_pin_float_newf(HAL_IN, &(data->SIGOUT_BOARD0_PWMOUT0_DTY_OFFSET), comp_id, "board0.pwmout0.dty-offset")) != 0) error_handler(retval);
    *data->SIGOUT_BOARD0_PWMOUT0_DTY_OFFSET = 0.0;
    if ((retval = hal_pin_float_newf(HAL_IN, &(data->SIGOUT_BOARD0_PWMOUT0_DTY), comp_id, "board0.pwmout0.dty")) != 0) error_handler(retval);
    *data->SIGOUT_BOARD0_PWMOUT0_DTY = 0;
    if ((retval = hal_pin_bit_newf(HAL_IN, &(data->SIGOUT_BOARD0_PWMOUT0_ENABLE), comp_id, "board0.pwmout0.enable")) != 0) error_handler(retval);
    *data->SIGOUT_BOARD0_PWMOUT0_ENABLE = 0;
    if ((retval = hal_pin_bit_newf(HAL_IN, &(data->SIGOUT_BOARD0_BITOUT0_BIT), comp_id, "board0.bitout0.bit")) != 0) error_handler(retval);
    *data->SIGOUT_BOARD0_BITOUT0_BIT = 0;
    if ((retval = hal_pin_bit_newf(HAL_IN, &(data->SIGOUT_BOARD0_BITOUT1_BIT), comp_id, "board0.bitout1.bit")) != 0) error_handler(retval);
    *data->SIGOUT_BOARD0_BITOUT1_BIT = 0;
    if ((retval = hal_pin_bit_newf(HAL_OUT, &(data->SIGIN_BOARD0_BITIN6_BIT), comp_id, "board0.bitin6.bit")) != 0) error_handler(retval);
    *data->SIGIN_BOARD0_BITIN6_BIT = 0;
    if ((retval = hal_pin_bit_newf(HAL_OUT, &(data->SIGIN_BOARD0_BITIN6_BIT_not), comp_id, "board0.bitin6.bit-not")) != 0) error_handler(retval);
    *data->SIGIN_BOARD0_BITIN6_BIT_not = 1 - *data->SIGIN_BOARD0_BITIN6_BIT;
    if ((retval = hal_pin_bit_newf(HAL_OUT, &(data->SIGIN_BOARD0_BITIN7_BIT), comp_id, "board0.bitin7.bit")) != 0) error_handler(retval);
    *data->SIGIN_BOARD0_BITIN7_BIT = 0;
    if ((retval = hal_pin_bit_newf(HAL_OUT, &(data->SIGIN_BOARD0_BITIN7_BIT_not), comp_id, "board0.bitin7.bit-not")) != 0) error_handler(retval);
    *data->SIGIN_BOARD0_BITIN7_BIT_not = 1 - *data->SIGIN_BOARD0_BITIN7_BIT;
    if ((retval = hal_pin_float_newf(HAL_IN, &(data->SIGIN_BOARD0_SATMCU0_FEED_POSITION_SCALE), comp_id, "board0.satmcu0.feed.position-scale")) != 0) error_handler(retval);
    *data->SIGIN_BOARD0_SATMCU0_FEED_POSITION_SCALE = 1.0;
    if ((retval = hal_pin_float_newf(HAL_IN, &(data->SIGIN_BOARD0_SATMCU0_FEED_POSITION_OFFSET), comp_id, "board0.satmcu0.feed.position-offset")) != 0) error_handler(retval);
    *data->SIGIN_BOARD0_SATMCU0_FEED_POSITION_OFFSET = 0.0;
    if ((retval = hal_pin_float_newf(HAL_OUT, &(data->SIGIN_BOARD0_SATMCU0_FEED_POSITION), comp_id, "board0.satmcu0.feed.position")) != 0) error_handler(retval);
    *data->SIGIN_BOARD0_SATMCU0_FEED_POSITION = 0;
    if ((retval = hal_pin_float_newf(HAL_OUT, &(data->SIGIN_BOARD0_SATMCU0_FEED_POSITION_ABS), comp_id, "board0.satmcu0.feed.position-abs")) != 0) error_handler(retval);
    *data->SIGIN_BOARD0_SATMCU0_FEED_POSITION_ABS = 0;
    if ((retval = hal_pin_s32_newf(HAL_OUT, &(data->SIGIN_BOARD0_SATMCU0_FEED_POSITION_S32), comp_id, "board0.satmcu0.feed.position-s32")) != 0) error_handler(retval);
    *data->SIGIN_BOARD0_SATMCU0_FEED_POSITION_S32 = 0;
    if ((retval = hal_pin_u32_newf(HAL_OUT, &(data->SIGIN_BOARD0_SATMCU0_FEED_POSITION_U32_ABS), comp_id, "board0.satmcu0.feed.position-u32-abs")) != 0) error_handler(retval);
    *data->SIGIN_BOARD0_SATMCU0_FEED_POSITION_U32_ABS = 0;
    if ((retval = hal_pin_bit_newf(HAL_OUT, &(data->SIGIN_BOARD0_SATUART0_TIMEOUT), comp_id, "board0.satuart0.timeout")) != 0) error_handler(retval);
    *data->SIGIN_BOARD0_SATUART0_TIMEOUT = 0;
    if ((retval = hal_pin_bit_newf(HAL_OUT, &(data->SIGIN_BOARD0_SATUART0_TIMEOUT_not), comp_id, "board0.satuart0.timeout-not")) != 0) error_handler(retval);
    *data->SIGIN_BOARD0_SATUART0_TIMEOUT_not = 1 - *data->SIGIN_BOARD0_SATUART0_TIMEOUT;
    if ((retval = hal_pin_float_newf(HAL_IN, &(data->SIGIN_BOARD0_SATMCU0_SPINDLE_POSITION_SCALE), comp_id, "board0.satmcu0.spindle.position-scale")) != 0) error_handler(retval);
    *data->SIGIN_BOARD0_SATMCU0_SPINDLE_POSITION_SCALE = 1.0;
    if ((retval = hal_pin_float_newf(HAL_IN, &(data->SIGIN_BOARD0_SATMCU0_SPINDLE_POSITION_OFFSET), comp_id, "board0.satmcu0.spindle.position-offset")) != 0) error_handler(retval);
    *data->SIGIN_BOARD0_SATMCU0_SPINDLE_POSITION_OFFSET = 0.0;
    if ((retval = hal_pin_float_newf(HAL_OUT, &(data->SIGIN_BOARD0_SATMCU0_SPINDLE_POSITION), comp_id, "board0.satmcu0.spindle.position")) != 0) error_handler(retval);
    *data->SIGIN_BOARD0_SATMCU0_SPINDLE_POSITION = 0;
    if ((retval = hal_pin_float_newf(HAL_OUT, &(data->SIGIN_BOARD0_SATMCU0_SPINDLE_POSITION_ABS), comp_id, "board0.satmcu0.spindle.position-abs")) != 0) error_handler(retval);
    *data->SIGIN_BOARD0_SATMCU0_SPINDLE_POSITION_ABS = 0;
    if ((retval = hal_pin_s32_newf(HAL_OUT, &(data->SIGIN_BOARD0_SATMCU0_SPINDLE_POSITION_S32), comp_id, "board0.satmcu0.spindle.position-s32")) != 0) error_handler(retval);
    *data->SIGIN_BOARD0_SATMCU0_SPINDLE_POSITION_S32 = 0;
    if ((retval = hal_pin_u32_newf(HAL_OUT, &(data->SIGIN_BOARD0_SATMCU0_SPINDLE_POSITION_U32_ABS), comp_id, "board0.satmcu0.spindle.position-u32-abs")) != 0) error_handler(retval);
    *data->SIGIN_BOARD0_SATMCU0_SPINDLE_POSITION_U32_ABS = 0;
    if ((retval = hal_pin_float_newf(HAL_IN, &(data->SIGIN_BOARD0_SATMCU0_RAPID_POSITION_SCALE), comp_id, "board0.satmcu0.rapid.position-scale")) != 0) error_handler(retval);
    *data->SIGIN_BOARD0_SATMCU0_RAPID_POSITION_SCALE = 1.0;
    if ((retval = hal_pin_float_newf(HAL_IN, &(data->SIGIN_BOARD0_SATMCU0_RAPID_POSITION_OFFSET), comp_id, "board0.satmcu0.rapid.position-offset")) != 0) error_handler(retval);
    *data->SIGIN_BOARD0_SATMCU0_RAPID_POSITION_OFFSET = 0.0;
    if ((retval = hal_pin_float_newf(HAL_OUT, &(data->SIGIN_BOARD0_SATMCU0_RAPID_POSITION), comp_id, "board0.satmcu0.rapid.position")) != 0) error_handler(retval);
    *data->SIGIN_BOARD0_SATMCU0_RAPID_POSITION = 0;
    if ((retval = hal_pin_float_newf(HAL_OUT, &(data->SIGIN_BOARD0_SATMCU0_RAPID_POSITION_ABS), comp_id, "board0.satmcu0.rapid.position-abs")) != 0) error_handler(retval);
    *data->SIGIN_BOARD0_SATMCU0_RAPID_POSITION_ABS = 0;
    if ((retval = hal_pin_s32_newf(HAL_OUT, &(data->SIGIN_BOARD0_SATMCU0_RAPID_POSITION_S32), comp_id, "board0.satmcu0.rapid.position-s32")) != 0) error_handler(retval);
    *data->SIGIN_BOARD0_SATMCU0_RAPID_POSITION_S32 = 0;
    if ((retval = hal_pin_u32_newf(HAL_OUT, &(data->SIGIN_BOARD0_SATMCU0_RAPID_POSITION_U32_ABS), comp_id, "board0.satmcu0.rapid.position-u32-abs")) != 0) error_handler(retval);
    *data->SIGIN_BOARD0_SATMCU0_RAPID_POSITION_U32_ABS = 0;
    if ((retval = hal_pin_float_newf(HAL_IN, &(data->SIGIN_BOARD0_SATMCU0_JOGWHEEL_POSITION_SCALE), comp_id, "board0.satmcu0.jogwheel.position-scale")) != 0) error_handler(retval);
    *data->SIGIN_BOARD0_SATMCU0_JOGWHEEL_POSITION_SCALE = 1.0;
    if ((retval = hal_pin_float_newf(HAL_IN, &(data->SIGIN_BOARD0_SATMCU0_JOGWHEEL_POSITION_OFFSET), comp_id, "board0.satmcu0.jogwheel.position-offset")) != 0) error_handler(retval);
    *data->SIGIN_BOARD0_SATMCU0_JOGWHEEL_POSITION_OFFSET = 0.0;
    if ((retval = hal_pin_float_newf(HAL_OUT, &(data->SIGIN_BOARD0_SATMCU0_JOGWHEEL_POSITION), comp_id, "board0.satmcu0.jogwheel.position")) != 0) error_handler(retval);
    *data->SIGIN_BOARD0_SATMCU0_JOGWHEEL_POSITION = 0;
    if ((retval = hal_pin_float_newf(HAL_OUT, &(data->SIGIN_BOARD0_SATMCU0_JOGWHEEL_POSITION_ABS), comp_id, "board0.satmcu0.jogwheel.position-abs")) != 0) error_handler(retval);
    *data->SIGIN_BOARD0_SATMCU0_JOGWHEEL_POSITION_ABS = 0;
    if ((retval = hal_pin_s32_newf(HAL_OUT, &(data->SIGIN_BOARD0_SATMCU0_JOGWHEEL_POSITION_S32), comp_id, "board0.satmcu0.jogwheel.position-s32")) != 0) error_handler(retval);
    *data->SIGIN_BOARD0_SATMCU0_JOGWHEEL_POSITION_S32 = 0;
    if ((retval = hal_pin_u32_newf(HAL_OUT, &(data->SIGIN_BOARD0_SATMCU0_JOGWHEEL_POSITION_U32_ABS), comp_id, "board0.satmcu0.jogwheel.position-u32-abs")) != 0) error_handler(retval);
    *data->SIGIN_BOARD0_SATMCU0_JOGWHEEL_POSITION_U32_ABS = 0;
    if ((retval = hal_pin_bit_newf(HAL_OUT, &(data->SIGIN_BOARD0_SATMCU0_MPGESTOP_BIT), comp_id, "board0.satmcu0.mpgestop.bit")) != 0) error_handler(retval);
    *data->SIGIN_BOARD0_SATMCU0_MPGESTOP_BIT = 0;
    if ((retval = hal_pin_bit_newf(HAL_OUT, &(data->SIGIN_BOARD0_SATMCU0_MPGESTOP_BIT_not), comp_id, "board0.satmcu0.mpgestop.bit-not")) != 0) error_handler(retval);
    *data->SIGIN_BOARD0_SATMCU0_MPGESTOP_BIT_not = 1 - *data->SIGIN_BOARD0_SATMCU0_MPGESTOP_BIT;
    if ((retval = hal_pin_bit_newf(HAL_OUT, &(data->SIGIN_BOARD0_SATMCU0_SCALE0_BIT), comp_id, "board0.satmcu0.scale0.bit")) != 0) error_handler(retval);
    *data->SIGIN_BOARD0_SATMCU0_SCALE0_BIT = 0;
    if ((retval = hal_pin_bit_newf(HAL_OUT, &(data->SIGIN_BOARD0_SATMCU0_SCALE0_BIT_not), comp_id, "board0.satmcu0.scale0.bit-not")) != 0) error_handler(retval);
    *data->SIGIN_BOARD0_SATMCU0_SCALE0_BIT_not = 1 - *data->SIGIN_BOARD0_SATMCU0_SCALE0_BIT;
    if ((retval = hal_pin_bit_newf(HAL_IN, &(data->SIGOUT_BOARD0_SATMCU0_LEDSCALE0_BIT), comp_id, "board0.satmcu0.ledscale0.bit")) != 0) error_handler(retval);
    *data->SIGOUT_BOARD0_SATMCU0_LEDSCALE0_BIT = 0;
    if ((retval = hal_pin_bit_newf(HAL_OUT, &(data->SIGIN_BOARD0_SATMCU0_SCALE1_BIT), comp_id, "board0.satmcu0.scale1.bit")) != 0) error_handler(retval);
    *data->SIGIN_BOARD0_SATMCU0_SCALE1_BIT = 0;
    if ((retval = hal_pin_bit_newf(HAL_OUT, &(data->SIGIN_BOARD0_SATMCU0_SCALE1_BIT_not), comp_id, "board0.satmcu0.scale1.bit-not")) != 0) error_handler(retval);
    *data->SIGIN_BOARD0_SATMCU0_SCALE1_BIT_not = 1 - *data->SIGIN_BOARD0_SATMCU0_SCALE1_BIT;
    if ((retval = hal_pin_bit_newf(HAL_OUT, &(data->SIGIN_BOARD0_SATMCU0_SCALE2_BIT), comp_id, "board0.satmcu0.scale2.bit")) != 0) error_handler(retval);
    *data->SIGIN_BOARD0_SATMCU0_SCALE2_BIT = 0;
    if ((retval = hal_pin_bit_newf(HAL_OUT, &(data->SIGIN_BOARD0_SATMCU0_SCALE2_BIT_not), comp_id, "board0.satmcu0.scale2.bit-not")) != 0) error_handler(retval);
    *data->SIGIN_BOARD0_SATMCU0_SCALE2_BIT_not = 1 - *data->SIGIN_BOARD0_SATMCU0_SCALE2_BIT;
    if ((retval = hal_pin_bit_newf(HAL_OUT, &(data->SIGIN_BOARD0_SATMCU0_SELECTX_BIT), comp_id, "board0.satmcu0.selectx.bit")) != 0) error_handler(retval);
    *data->SIGIN_BOARD0_SATMCU0_SELECTX_BIT = 0;
    if ((retval = hal_pin_bit_newf(HAL_OUT, &(data->SIGIN_BOARD0_SATMCU0_SELECTX_BIT_not), comp_id, "board0.satmcu0.selectx.bit-not")) != 0) error_handler(retval);
    *data->SIGIN_BOARD0_SATMCU0_SELECTX_BIT_not = 1 - *data->SIGIN_BOARD0_SATMCU0_SELECTX_BIT;
    if ((retval = hal_pin_bit_newf(HAL_OUT, &(data->SIGIN_BOARD0_SATMCU0_SELECTY_BIT), comp_id, "board0.satmcu0.selecty.bit")) != 0) error_handler(retval);
    *data->SIGIN_BOARD0_SATMCU0_SELECTY_BIT = 0;
    if ((retval = hal_pin_bit_newf(HAL_OUT, &(data->SIGIN_BOARD0_SATMCU0_SELECTY_BIT_not), comp_id, "board0.satmcu0.selecty.bit-not")) != 0) error_handler(retval);
    *data->SIGIN_BOARD0_SATMCU0_SELECTY_BIT_not = 1 - *data->SIGIN_BOARD0_SATMCU0_SELECTY_BIT;
    if ((retval = hal_pin_bit_newf(HAL_IN, &(data->SIGOUT_BOARD0_SATMCU0_LEDSCALE1_BIT), comp_id, "board0.satmcu0.ledscale1.bit")) != 0) error_handler(retval);
    *data->SIGOUT_BOARD0_SATMCU0_LEDSCALE1_BIT = 0;
    if ((retval = hal_pin_bit_newf(HAL_IN, &(data->SIGOUT_BOARD0_SATMCU0_LEDSCALE2_BIT), comp_id, "board0.satmcu0.ledscale2.bit")) != 0) error_handler(retval);
    *data->SIGOUT_BOARD0_SATMCU0_LEDSCALE2_BIT = 0;
    if ((retval = hal_pin_bit_newf(HAL_IN, &(data->SIGOUT_BOARD0_SATMCU0_SELECTEDX_BIT), comp_id, "board0.satmcu0.selectedx.bit")) != 0) error_handler(retval);
    *data->SIGOUT_BOARD0_SATMCU0_SELECTEDX_BIT = 0;
    if ((retval = hal_pin_bit_newf(HAL_IN, &(data->SIGOUT_BOARD0_SATMCU0_SELECTEDY_BIT), comp_id, "board0.satmcu0.selectedy.bit")) != 0) error_handler(retval);
    *data->SIGOUT_BOARD0_SATMCU0_SELECTEDY_BIT = 0;
    if ((retval = hal_pin_bit_newf(HAL_IN, &(data->SIGOUT_BOARD0_SATMCU0_SELECTEDZ_BIT), comp_id, "board0.satmcu0.selectedz.bit")) != 0) error_handler(retval);
    *data->SIGOUT_BOARD0_SATMCU0_SELECTEDZ_BIT = 0;
    if ((retval = hal_pin_bit_newf(HAL_OUT, &(data->SIGIN_BOARD0_SATMCU0_SELECTZ_BIT), comp_id, "board0.satmcu0.selectz.bit")) != 0) error_handler(retval);
    *data->SIGIN_BOARD0_SATMCU0_SELECTZ_BIT = 0;
    if ((retval = hal_pin_bit_newf(HAL_OUT, &(data->SIGIN_BOARD0_SATMCU0_SELECTZ_BIT_not), comp_id, "board0.satmcu0.selectz.bit-not")) != 0) error_handler(retval);
    *data->SIGIN_BOARD0_SATMCU0_SELECTZ_BIT_not = 1 - *data->SIGIN_BOARD0_SATMCU0_SELECTZ_BIT;
    if ((retval = hal_pin_bit_newf(HAL_OUT, &(data->SIGIN_BOARD0_SATMCU0_LBUTTON_BIT), comp_id, "board0.satmcu0.lbutton.bit")) != 0) error_handler(retval);
    *data->SIGIN_BOARD0_SATMCU0_LBUTTON_BIT = 0;
    if ((retval = hal_pin_bit_newf(HAL_OUT, &(data->SIGIN_BOARD0_SATMCU0_LBUTTON_BIT_not), comp_id, "board0.satmcu0.lbutton.bit-not")) != 0) error_handler(retval);
    *data->SIGIN_BOARD0_SATMCU0_LBUTTON_BIT_not = 1 - *data->SIGIN_BOARD0_SATMCU0_LBUTTON_BIT;
    if ((retval = hal_pin_bit_newf(HAL_OUT, &(data->SIGIN_BOARD0_SATMCU0_LBUTTON_BIT_SHORT), comp_id, "board0.satmcu0.lbutton.bit_short")) != 0) error_handler(retval);
    *data->SIGIN_BOARD0_SATMCU0_LBUTTON_BIT_SHORT = 0;
    if ((retval = hal_pin_bit_newf(HAL_OUT, &(data->SIGIN_BOARD0_SATMCU0_LBUTTON_BIT_SHORT_not), comp_id, "board0.satmcu0.lbutton.bit_short-not")) != 0) error_handler(retval);
    *data->SIGIN_BOARD0_SATMCU0_LBUTTON_BIT_SHORT_not = 1 - *data->SIGIN_BOARD0_SATMCU0_LBUTTON_BIT_SHORT;
    if ((retval = hal_pin_bit_newf(HAL_OUT, &(data->SIGIN_BOARD0_SATMCU0_LBUTTON_BIT_LONG1), comp_id, "board0.satmcu0.lbutton.bit_long1")) != 0) error_handler(retval);
    *data->SIGIN_BOARD0_SATMCU0_LBUTTON_BIT_LONG1 = 0;
    if ((retval = hal_pin_bit_newf(HAL_OUT, &(data->SIGIN_BOARD0_SATMCU0_LBUTTON_BIT_LONG1_not), comp_id, "board0.satmcu0.lbutton.bit_long1-not")) != 0) error_handler(retval);
    *data->SIGIN_BOARD0_SATMCU0_LBUTTON_BIT_LONG1_not = 1 - *data->SIGIN_BOARD0_SATMCU0_LBUTTON_BIT_LONG1;
    if ((retval = hal_pin_bit_newf(HAL_OUT, &(data->SIGIN_BOARD0_SATMCU0_LBUTTON_BIT_LONG2), comp_id, "board0.satmcu0.lbutton.bit_long2")) != 0) error_handler(retval);
    *data->SIGIN_BOARD0_SATMCU0_LBUTTON_BIT_LONG2 = 0;
    if ((retval = hal_pin_bit_newf(HAL_OUT, &(data->SIGIN_BOARD0_SATMCU0_LBUTTON_BIT_LONG2_not), comp_id, "board0.satmcu0.lbutton.bit_long2-not")) != 0) error_handler(retval);
    *data->SIGIN_BOARD0_SATMCU0_LBUTTON_BIT_LONG2_not = 1 - *data->SIGIN_BOARD0_SATMCU0_LBUTTON_BIT_LONG2;
    if ((retval = hal_pin_bit_newf(HAL_OUT, &(data->SIGIN_BOARD0_SATMCU0_CBUTTON_BIT), comp_id, "board0.satmcu0.cbutton.bit")) != 0) error_handler(retval);
    *data->SIGIN_BOARD0_SATMCU0_CBUTTON_BIT = 0;
    if ((retval = hal_pin_bit_newf(HAL_OUT, &(data->SIGIN_BOARD0_SATMCU0_CBUTTON_BIT_not), comp_id, "board0.satmcu0.cbutton.bit-not")) != 0) error_handler(retval);
    *data->SIGIN_BOARD0_SATMCU0_CBUTTON_BIT_not = 1 - *data->SIGIN_BOARD0_SATMCU0_CBUTTON_BIT;
    if ((retval = hal_pin_bit_newf(HAL_OUT, &(data->SIGIN_BOARD0_SATMCU0_RBUTTON_BIT), comp_id, "board0.satmcu0.rbutton.bit")) != 0) error_handler(retval);
    *data->SIGIN_BOARD0_SATMCU0_RBUTTON_BIT = 0;
    if ((retval = hal_pin_bit_newf(HAL_OUT, &(data->SIGIN_BOARD0_SATMCU0_RBUTTON_BIT_not), comp_id, "board0.satmcu0.rbutton.bit-not")) != 0) error_handler(retval);
    *data->SIGIN_BOARD0_SATMCU0_RBUTTON_BIT_not = 1 - *data->SIGIN_BOARD0_SATMCU0_RBUTTON_BIT;
    if ((retval = hal_pin_bit_newf(HAL_OUT, &(data->SIGIN_BOARD0_SATMCU0_RBUTTON_BIT_SHORT), comp_id, "board0.satmcu0.rbutton.bit_short")) != 0) error_handler(retval);
    *data->SIGIN_BOARD0_SATMCU0_RBUTTON_BIT_SHORT = 0;
    if ((retval = hal_pin_bit_newf(HAL_OUT, &(data->SIGIN_BOARD0_SATMCU0_RBUTTON_BIT_SHORT_not), comp_id, "board0.satmcu0.rbutton.bit_short-not")) != 0) error_handler(retval);
    *data->SIGIN_BOARD0_SATMCU0_RBUTTON_BIT_SHORT_not = 1 - *data->SIGIN_BOARD0_SATMCU0_RBUTTON_BIT_SHORT;
    if ((retval = hal_pin_bit_newf(HAL_OUT, &(data->SIGIN_BOARD0_SATMCU0_RBUTTON_BIT_LONG1), comp_id, "board0.satmcu0.rbutton.bit_long1")) != 0) error_handler(retval);
    *data->SIGIN_BOARD0_SATMCU0_RBUTTON_BIT_LONG1 = 0;
    if ((retval = hal_pin_bit_newf(HAL_OUT, &(data->SIGIN_BOARD0_SATMCU0_RBUTTON_BIT_LONG1_not), comp_id, "board0.satmcu0.rbutton.bit_long1-not")) != 0) error_handler(retval);
    *data->SIGIN_BOARD0_SATMCU0_RBUTTON_BIT_LONG1_not = 1 - *data->SIGIN_BOARD0_SATMCU0_RBUTTON_BIT_LONG1;
    if ((retval = hal_pin_bit_newf(HAL_OUT, &(data->SIGIN_BOARD0_SATMCU0_RBUTTON_BIT_LONG2), comp_id, "board0.satmcu0.rbutton.bit_long2")) != 0) error_handler(retval);
    *data->SIGIN_BOARD0_SATMCU0_RBUTTON_BIT_LONG2 = 0;
    if ((retval = hal_pin_bit_newf(HAL_OUT, &(data->SIGIN_BOARD0_SATMCU0_RBUTTON_BIT_LONG2_not), comp_id, "board0.satmcu0.rbutton.bit_long2-not")) != 0) error_handler(retval);
    *data->SIGIN_BOARD0_SATMCU0_RBUTTON_BIT_LONG2_not = 1 - *data->SIGIN_BOARD0_SATMCU0_RBUTTON_BIT_LONG2;
    return data;
}

/*
    interface: UDP
*/

#include <sys/socket.h>
#include <arpa/inet.h>
#include <netinet/in.h>

#define SEND_TIMEOUT_US 10
#define RECV_TIMEOUT_US 10
#define READ_PCK_DELAY_NS 1000
#define READ_PCK_TIMEOUT_MS 2

static int udpSocket;
static int errCount;
struct sockaddr_in dstAddr, srcAddr;
struct hostent *server;

int udp_init(const char *dstAddress, int dstPort, int srcPort) {
    int ret;

    // Create a UDP socket
    udpSocket = socket(PF_INET, SOCK_DGRAM, IPPROTO_UDP);
    if (udpSocket < 0) {
        rtapi_print("ERROR: can't open socket: %s\n", strerror(errno));
        return -errno;
    }

    bzero((char*) &dstAddr, sizeof(dstAddr));
    dstAddr.sin_family = AF_INET;
    dstAddr.sin_addr.s_addr = inet_addr(dstAddress);
    dstAddr.sin_port = htons(dstPort);

    bzero((char*) &srcAddr, sizeof(srcAddr));
    srcAddr.sin_family = AF_INET;
    srcAddr.sin_addr.s_addr = htonl(INADDR_ANY);
    srcAddr.sin_port = htons(srcPort);

    rtapi_print("INFO: target is udp port: %s:%i\n", dstAddress, dstPort);
    rtapi_print("INFO: listening on udp port: %s:%i\n", "0.0.0.0", srcPort);

    // bind the local socket to SCR_PORT
    ret = bind(udpSocket, (struct sockaddr *) &srcAddr, sizeof(srcAddr));
    if (ret < 0) {
        rtapi_print("ERROR: can't bind: %s\n", strerror(errno));
        return -errno;
    }

    // Connect to send and receive only to the server_addr
    ret = connect(udpSocket, (struct sockaddr*) &dstAddr, sizeof(struct sockaddr_in));
    if (ret < 0) {
        rtapi_print("ERROR: can't connect: %s\n", strerror(errno));
        return -errno;
    }

    struct timeval timeout;
    timeout.tv_sec = 0;
    timeout.tv_usec = RECV_TIMEOUT_US;

    ret = setsockopt(udpSocket, SOL_SOCKET, SO_RCVTIMEO, (char*) &timeout, sizeof(timeout));
    if (ret < 0) {
        rtapi_print("ERROR: can't set receive timeout socket option: %s\n", strerror(errno));
        return -errno;
    }

    timeout.tv_usec = SEND_TIMEOUT_US;
    ret = setsockopt(udpSocket, SOL_SOCKET, SO_SNDTIMEO, (char*) &timeout,
                     sizeof(timeout));
    if (ret < 0) {
        rtapi_print("ERROR: can't set send timeout socket option: %s\n", strerror(errno));
        return -errno;
    }

    return 0;
}

void udp_tx(uint8_t *txBuffer, uint16_t size) {
    // Send datagram
    send(udpSocket, txBuffer, size, 0);
}

int udp_rx(uint8_t *rxBuffer, uint16_t size, uint8_t udp_async) {
    int i;
    int ret;
    int64_t t1;
    int64_t t2;
    uint8_t rxBufferTmp[1024];

    for (i = 0; i < 1024; i++) {
        rxBufferTmp[i] = 0;
    }

    // Receive incoming datagram
    if (udp_async == 1) {
        ret = recv(udpSocket, rxBufferTmp, size * 2, MSG_DONTWAIT);
    } else {
        t1 = rtapi_get_time();
        do {
            ret = recv(udpSocket, rxBufferTmp, size * 2, 0);
            if (ret < 0) {
                rtapi_delay(READ_PCK_DELAY_NS);
            }
            t2 = rtapi_get_time();
        }
        while ((ret < 0) && ((t2 - t1) < READ_PCK_TIMEOUT_MS * 1000 * 1000));
    }

    if (ret > 0) {
        errCount = 0;
        if (ret == size) {
            memcpy(rxBuffer, rxBufferTmp, size);
        } else {
            rtapi_print("wrong size = %d\n", ret);
            for (i = 0; i < ret; i++) {
                rtapi_print("%d ", rxBufferTmp[i]);
            }
            rtapi_print("\n");
        }
        /*
        printf("rx:");
        for (i = 0; i < ret; i++) {
            printf(" %d,", rxBuffer[i]);
        }
        printf("\n");
        */
    } else {
        errCount++;
        // rtapi_print("Ethernet TIMEOUT: N = %d (ret: %d)\n", errCount, ret);
    }

    return ret;
}

void udp_exit(void) {
}

int interface_init(int argc, char **argv) {
    char dstAddress[20];
    int dstPort = DST_PORT;
    if (argc > 1) {
        int ip0 = 0;
        int ip1 = 0;
        int ip2 = 0;
        int ip3 = 0;
        int port = 0;
        int ret = sscanf(argv[1], "%d.%d.%d.%d:%d", &ip0, &ip1, &ip2, &ip3, &port);
        if (ret >= 4) {
            snprintf(dstAddress, sizeof(dstAddress), "%d.%d.%d.%d", ip0, ip1, ip2, ip3);
            if (ret == 5) {
                dstPort = port;
            }
        }
        udp_init(dstAddress, dstPort, SRC_PORT);
    } else {
        udp_init(UDP_IP, DST_PORT, SRC_PORT);
    }
    return 0;
}

void interface_exit(void) {
    udp_exit();
}


/*
    hal functions
*/

/***********************************************************************
*                       HELPER FUNCTIONS                               *
************************************************************************/

uint16_t crc16_update(uint16_t crc, uint8_t a) {
    int i;

    crc ^= (uint16_t)a;
    for (i = 0; i < 8; ++i) {
        if (crc & 1)
            crc = (crc >> 1) ^ 0xA001;
        else
            crc = (crc >> 1);
    }

    return crc;
}

int error_handler(int retval) {
    if (retval < 0) {
        rtapi_print_msg(RTAPI_MSG_ERR, "%s: ERROR: pin export failed with err=%i\n", modname, retval);
        hal_exit(comp_id);
        return -1;
    }
    return 0;
}

int rtapi_app_main(void) {
    char name[HAL_NAME_LEN + 1];
    int retval = 0;
    data = hal_malloc(sizeof(data_t));
    comp_id = hal_init(modname);
    if (comp_id < 0) {
        rtapi_print_msg(RTAPI_MSG_ERR, "%s ERROR: hal_init() failed \n", modname);
        return -1;
    }
    register_signals();
    rtapi_snprintf(name, sizeof(name), "%s.update-freq", prefix);
    rtapi_snprintf(name, sizeof(name), "%s.readwrite", prefix);
    retval = hal_export_funct(name, rio_readwrite, data, 1, 0, comp_id);
    if (retval < 0) {
        rtapi_print_msg(RTAPI_MSG_ERR, "%s: ERROR: read function export failed\n", modname);
        hal_exit(comp_id);
        return -1;
    }
    rtapi_print_msg(RTAPI_MSG_INFO, "%s: installed driver\n", modname);
    hal_ready(comp_id);

    interface_init(0, NULL);

    rio_readwrite(NULL, 0);

    return 0;
}

void rtapi_app_exit(void) {
    interface_exit();
    hal_exit(comp_id);
}

/***********************************************************************/


/***********************************************************************
*                         PLUGIN GLOBALS                               *
************************************************************************/








































/***********************************************************************/

// Generated by component_signal_converter()
// output: SIGOUT -> calc -> VAROUT -> txBuffer
void convert_varout32_stepdir0_velocity(data_t *data) {
    float value = *data->SIGOUT_BOARD0_STEPDIR0_VELOCITY;
    value = value * *data->SIGOUT_BOARD0_STEPDIR0_VELOCITY_SCALE;
    value = value + *data->SIGOUT_BOARD0_STEPDIR0_VELOCITY_OFFSET;
    if (value != 0) {
        value = OSC_CLOCK / value / 2;
    }
    data->VAROUT32_STEPDIR0_VELOCITY = value;
}

void convert_varout1_stepdir0_enable(data_t *data) {
    bool value = *data->SIGOUT_BOARD0_STEPDIR0_ENABLE;
    data->VAROUT1_STEPDIR0_ENABLE = value;
}

void convert_varout32_stepdir1_velocity(data_t *data) {
    float value = *data->SIGOUT_BOARD0_STEPDIR1_VELOCITY;
    value = value * *data->SIGOUT_BOARD0_STEPDIR1_VELOCITY_SCALE;
    value = value + *data->SIGOUT_BOARD0_STEPDIR1_VELOCITY_OFFSET;
    if (value != 0) {
        value = OSC_CLOCK / value / 2;
    }
    data->VAROUT32_STEPDIR1_VELOCITY = value;
}

void convert_varout1_stepdir1_enable(data_t *data) {
    bool value = *data->SIGOUT_BOARD0_STEPDIR1_ENABLE;
    data->VAROUT1_STEPDIR1_ENABLE = value;
}

void convert_varout32_stepdir2_velocity(data_t *data) {
    float value = *data->SIGOUT_BOARD0_STEPDIR2_VELOCITY;
    value = value * *data->SIGOUT_BOARD0_STEPDIR2_VELOCITY_SCALE;
    value = value + *data->SIGOUT_BOARD0_STEPDIR2_VELOCITY_OFFSET;
    if (value != 0) {
        value = OSC_CLOCK / value / 2;
    }
    data->VAROUT32_STEPDIR2_VELOCITY = value;
}

void convert_varout1_stepdir2_enable(data_t *data) {
    bool value = *data->SIGOUT_BOARD0_STEPDIR2_ENABLE;
    data->VAROUT1_STEPDIR2_ENABLE = value;
}

void convert_varout16_pwmout0_dty(data_t *data) {
    float value = *data->SIGOUT_BOARD0_PWMOUT0_DTY;
    value = value * *data->SIGOUT_BOARD0_PWMOUT0_DTY_SCALE;
    value = value + *data->SIGOUT_BOARD0_PWMOUT0_DTY_OFFSET;
    value = (value - 0) * (OSC_CLOCK / 1000) / (100 - 0);
    data->VAROUT16_PWMOUT0_DTY = value;
}

void convert_varout1_pwmout0_enable(data_t *data) {
    bool value = *data->SIGOUT_BOARD0_PWMOUT0_ENABLE;
    data->VAROUT1_PWMOUT0_ENABLE = value;
}

void convert_varout1_bitout0_bit(data_t *data) {
    bool value = *data->SIGOUT_BOARD0_BITOUT0_BIT;
    data->VAROUT1_BITOUT0_BIT = value;
}

void convert_varout1_bitout1_bit(data_t *data) {
    bool value = *data->SIGOUT_BOARD0_BITOUT1_BIT;
    data->VAROUT1_BITOUT1_BIT = value;
}

void convert_varout1_ledscale0_bit(data_t *data) {
    bool value = *data->SIGOUT_BOARD0_SATMCU0_LEDSCALE0_BIT;
    data->VAROUT1_LEDSCALE0_BIT = value;
}

void convert_varout1_ledscale1_bit(data_t *data) {
    bool value = *data->SIGOUT_BOARD0_SATMCU0_LEDSCALE1_BIT;
    data->VAROUT1_LEDSCALE1_BIT = value;
}

void convert_varout1_ledscale2_bit(data_t *data) {
    bool value = *data->SIGOUT_BOARD0_SATMCU0_LEDSCALE2_BIT;
    data->VAROUT1_LEDSCALE2_BIT = value;
}

void convert_varout1_selectedx_bit(data_t *data) {
    bool value = *data->SIGOUT_BOARD0_SATMCU0_SELECTEDX_BIT;
    data->VAROUT1_SELECTEDX_BIT = value;
}

void convert_varout1_selectedy_bit(data_t *data) {
    bool value = *data->SIGOUT_BOARD0_SATMCU0_SELECTEDY_BIT;
    data->VAROUT1_SELECTEDY_BIT = value;
}

void convert_varout1_selectedz_bit(data_t *data) {
    bool value = *data->SIGOUT_BOARD0_SATMCU0_SELECTEDZ_BIT;
    data->VAROUT1_SELECTEDZ_BIT = value;
}


// input: rxBuffer -> VAROUT -> calc -> SIGOUT
void convert_sigin_board0_bitin0_bit(data_t *data) {
    bool value = data->VARIN1_BITIN0_BIT;
    *data->SIGIN_BOARD0_BITIN0_BIT = value;
    *data->SIGIN_BOARD0_BITIN0_BIT_not = 1 - value;
}

void convert_sigin_board0_bitin1_bit(data_t *data) {
    bool value = data->VARIN1_BITIN1_BIT;
    *data->SIGIN_BOARD0_BITIN1_BIT = value;
    *data->SIGIN_BOARD0_BITIN1_BIT_not = 1 - value;
}

void convert_sigin_board0_bitin2_bit(data_t *data) {
    bool value = data->VARIN1_BITIN2_BIT;
    *data->SIGIN_BOARD0_BITIN2_BIT = value;
    *data->SIGIN_BOARD0_BITIN2_BIT_not = 1 - value;
}

void convert_sigin_board0_stepdir0_position(data_t *data) {
    float value = data->VARIN32_STEPDIR0_POSITION;
    float offset = *data->SIGIN_BOARD0_STEPDIR0_POSITION_OFFSET;
    float scale = *data->SIGIN_BOARD0_STEPDIR0_POSITION_SCALE;
    value = value + offset;
    value = value / scale;
    if (*data->sys_simulation == 1) {
        value = *data->SIGIN_BOARD0_STEPDIR0_POSITION + *data->SIGOUT_BOARD0_STEPDIR0_VELOCITY / 1000.0;
        // simulating X homing
        float home_offset = 80.0;
        if (value < home_offset) {
            data->VARIN1_BITIN0_BIT = 1;
        } else {
            data->VARIN1_BITIN0_BIT = 0;
        }
    }
    *data->SIGIN_BOARD0_STEPDIR0_POSITION_ABS = fabs(value);
    *data->SIGIN_BOARD0_STEPDIR0_POSITION_S32 = value;
    *data->SIGIN_BOARD0_STEPDIR0_POSITION_U32_ABS = fabs(value);
    *data->SIGIN_BOARD0_STEPDIR0_POSITION = value;
}

void convert_sigin_board0_stepdir1_position(data_t *data) {
    float value = data->VARIN32_STEPDIR1_POSITION;
    float offset = *data->SIGIN_BOARD0_STEPDIR1_POSITION_OFFSET;
    float scale = *data->SIGIN_BOARD0_STEPDIR1_POSITION_SCALE;
    value = value + offset;
    value = value / scale;
    if (*data->sys_simulation == 1) {
        value = *data->SIGIN_BOARD0_STEPDIR1_POSITION + *data->SIGOUT_BOARD0_STEPDIR1_VELOCITY / 1000.0;
        // simulating Y homing
        float home_offset = 20.0;
        if (value < home_offset) {
            data->VARIN1_BITIN1_BIT = 1;
        } else {
            data->VARIN1_BITIN1_BIT = 0;
        }
    }
    *data->SIGIN_BOARD0_STEPDIR1_POSITION_ABS = fabs(value);
    *data->SIGIN_BOARD0_STEPDIR1_POSITION_S32 = value;
    *data->SIGIN_BOARD0_STEPDIR1_POSITION_U32_ABS = fabs(value);
    *data->SIGIN_BOARD0_STEPDIR1_POSITION = value;
}

void convert_sigin_board0_stepdir2_position(data_t *data) {
    float value = data->VARIN32_STEPDIR2_POSITION;
    float offset = *data->SIGIN_BOARD0_STEPDIR2_POSITION_OFFSET;
    float scale = *data->SIGIN_BOARD0_STEPDIR2_POSITION_SCALE;
    value = value + offset;
    value = value / scale;
    if (*data->sys_simulation == 1) {
        value = *data->SIGIN_BOARD0_STEPDIR2_POSITION + *data->SIGOUT_BOARD0_STEPDIR2_VELOCITY / 1000.0;
        // simulating Z homing
        float home_offset = -15.0;
        if (value > home_offset) {
            data->VARIN1_BITIN2_BIT = 1;
        } else {
            data->VARIN1_BITIN2_BIT = 0;
        }
    }
    *data->SIGIN_BOARD0_STEPDIR2_POSITION_ABS = fabs(value);
    *data->SIGIN_BOARD0_STEPDIR2_POSITION_S32 = value;
    *data->SIGIN_BOARD0_STEPDIR2_POSITION_U32_ABS = fabs(value);
    *data->SIGIN_BOARD0_STEPDIR2_POSITION = value;
}

void convert_sigin_board0_bitin3_bit(data_t *data) {
    bool value = data->VARIN1_BITIN3_BIT;
    *data->SIGIN_BOARD0_BITIN3_BIT = value;
    *data->SIGIN_BOARD0_BITIN3_BIT_not = 1 - value;
}

void convert_sigin_board0_bitin4_bit(data_t *data) {
    bool value = data->VARIN1_BITIN4_BIT;
    *data->SIGIN_BOARD0_BITIN4_BIT = value;
    *data->SIGIN_BOARD0_BITIN4_BIT_not = 1 - value;
}

void convert_sigin_board0_bitin5_bit(data_t *data) {
    bool value = data->VARIN1_BITIN5_BIT;
    *data->SIGIN_BOARD0_BITIN5_BIT = value;
    *data->SIGIN_BOARD0_BITIN5_BIT_not = 1 - value;
}

void convert_sigin_board0_bitin6_bit(data_t *data) {
    bool value = data->VARIN1_BITIN6_BIT;
    *data->SIGIN_BOARD0_BITIN6_BIT = value;
    *data->SIGIN_BOARD0_BITIN6_BIT_not = 1 - value;
}

void convert_sigin_board0_bitin7_bit(data_t *data) {
    bool value = data->VARIN1_BITIN7_BIT;
    *data->SIGIN_BOARD0_BITIN7_BIT = value;
    *data->SIGIN_BOARD0_BITIN7_BIT_not = 1 - value;
}

void convert_sigin_board0_satmcu0_feed_position(data_t *data) {
    float value = data->VARIN32_FEED_POSITION;
    float offset = *data->SIGIN_BOARD0_SATMCU0_FEED_POSITION_OFFSET;
    float scale = *data->SIGIN_BOARD0_SATMCU0_FEED_POSITION_SCALE;
    value = value + offset;
    value = value / scale;
    *data->SIGIN_BOARD0_SATMCU0_FEED_POSITION_ABS = fabs(value);
    *data->SIGIN_BOARD0_SATMCU0_FEED_POSITION_S32 = value;
    *data->SIGIN_BOARD0_SATMCU0_FEED_POSITION_U32_ABS = fabs(value);
    *data->SIGIN_BOARD0_SATMCU0_FEED_POSITION = value;
}

void convert_sigin_board0_satuart0_timeout(data_t *data) {
    bool value = data->VARIN1_SATUART0_TIMEOUT;
    *data->SIGIN_BOARD0_SATUART0_TIMEOUT = value;
    *data->SIGIN_BOARD0_SATUART0_TIMEOUT_not = 1 - value;
}

void convert_sigin_board0_satmcu0_spindle_position(data_t *data) {
    float value = data->VARIN32_SPINDLE_POSITION;
    float offset = *data->SIGIN_BOARD0_SATMCU0_SPINDLE_POSITION_OFFSET;
    float scale = *data->SIGIN_BOARD0_SATMCU0_SPINDLE_POSITION_SCALE;
    value = value + offset;
    value = value / scale;
    *data->SIGIN_BOARD0_SATMCU0_SPINDLE_POSITION_ABS = fabs(value);
    *data->SIGIN_BOARD0_SATMCU0_SPINDLE_POSITION_S32 = value;
    *data->SIGIN_BOARD0_SATMCU0_SPINDLE_POSITION_U32_ABS = fabs(value);
    *data->SIGIN_BOARD0_SATMCU0_SPINDLE_POSITION = value;
}

void convert_sigin_board0_satmcu0_rapid_position(data_t *data) {
    float value = data->VARIN32_RAPID_POSITION;
    float offset = *data->SIGIN_BOARD0_SATMCU0_RAPID_POSITION_OFFSET;
    float scale = *data->SIGIN_BOARD0_SATMCU0_RAPID_POSITION_SCALE;
    value = value + offset;
    value = value / scale;
    *data->SIGIN_BOARD0_SATMCU0_RAPID_POSITION_ABS = fabs(value);
    *data->SIGIN_BOARD0_SATMCU0_RAPID_POSITION_S32 = value;
    *data->SIGIN_BOARD0_SATMCU0_RAPID_POSITION_U32_ABS = fabs(value);
    *data->SIGIN_BOARD0_SATMCU0_RAPID_POSITION = value;
}

void convert_sigin_board0_satmcu0_jogwheel_position(data_t *data) {
    float value = data->VARIN32_JOGWHEEL_POSITION;
    float offset = *data->SIGIN_BOARD0_SATMCU0_JOGWHEEL_POSITION_OFFSET;
    float scale = *data->SIGIN_BOARD0_SATMCU0_JOGWHEEL_POSITION_SCALE;
    value = value + offset;
    value = value / scale;
    *data->SIGIN_BOARD0_SATMCU0_JOGWHEEL_POSITION_ABS = fabs(value);
    *data->SIGIN_BOARD0_SATMCU0_JOGWHEEL_POSITION_S32 = value;
    *data->SIGIN_BOARD0_SATMCU0_JOGWHEEL_POSITION_U32_ABS = fabs(value);
    *data->SIGIN_BOARD0_SATMCU0_JOGWHEEL_POSITION = value;
}

void convert_sigin_board0_satmcu0_mpgestop_bit(data_t *data) {
    bool value = data->VARIN1_MPGESTOP_BIT;
    *data->SIGIN_BOARD0_SATMCU0_MPGESTOP_BIT = value;
    *data->SIGIN_BOARD0_SATMCU0_MPGESTOP_BIT_not = 1 - value;
}

void convert_sigin_board0_satmcu0_scale0_bit(data_t *data) {
    bool value = data->VARIN1_SCALE0_BIT;
    *data->SIGIN_BOARD0_SATMCU0_SCALE0_BIT = value;
    *data->SIGIN_BOARD0_SATMCU0_SCALE0_BIT_not = 1 - value;
}

void convert_sigin_board0_satmcu0_scale1_bit(data_t *data) {
    bool value = data->VARIN1_SCALE1_BIT;
    *data->SIGIN_BOARD0_SATMCU0_SCALE1_BIT = value;
    *data->SIGIN_BOARD0_SATMCU0_SCALE1_BIT_not = 1 - value;
}

void convert_sigin_board0_satmcu0_scale2_bit(data_t *data) {
    bool value = data->VARIN1_SCALE2_BIT;
    *data->SIGIN_BOARD0_SATMCU0_SCALE2_BIT = value;
    *data->SIGIN_BOARD0_SATMCU0_SCALE2_BIT_not = 1 - value;
}

void convert_sigin_board0_satmcu0_selectx_bit(data_t *data) {
    bool value = data->VARIN1_SELECTX_BIT;
    *data->SIGIN_BOARD0_SATMCU0_SELECTX_BIT = value;
    *data->SIGIN_BOARD0_SATMCU0_SELECTX_BIT_not = 1 - value;
}

void convert_sigin_board0_satmcu0_selecty_bit(data_t *data) {
    bool value = data->VARIN1_SELECTY_BIT;
    *data->SIGIN_BOARD0_SATMCU0_SELECTY_BIT = value;
    *data->SIGIN_BOARD0_SATMCU0_SELECTY_BIT_not = 1 - value;
}

void convert_sigin_board0_satmcu0_selectz_bit(data_t *data) {
    bool value = data->VARIN1_SELECTZ_BIT;
    *data->SIGIN_BOARD0_SATMCU0_SELECTZ_BIT = value;
    *data->SIGIN_BOARD0_SATMCU0_SELECTZ_BIT_not = 1 - value;
}

void convert_sigin_board0_satmcu0_lbutton_bit(data_t *data) {
    bool value = data->VARIN1_LBUTTON_BIT;
    *data->SIGIN_BOARD0_SATMCU0_LBUTTON_BIT = value;
    *data->SIGIN_BOARD0_SATMCU0_LBUTTON_BIT_not = 1 - value;
}

void convert_sigin_board0_satmcu0_lbutton_bit_short(data_t *data) {
    bool value = data->VARIN1_LBUTTON_BIT;
    static bool last = 0;
    static uint16_t press_timer = 0;
    static uint16_t reset_timer = 0;
    if (value == 1) {
        if (press_timer < 9000) {
            press_timer++;
        }
    } else if (last == 1 && value == 0) {
        reset_timer = servo_period * 100 / 1000000;
        if ((servo_period * press_timer / 1000000) > 1500) {
            // long 2
            *data->SIGIN_BOARD0_SATMCU0_LBUTTON_BIT_LONG2 = 1;
            *data->SIGIN_BOARD0_SATMCU0_LBUTTON_BIT_LONG2_not = 0;
        } else if ((servo_period * press_timer / 1000000) > 500) {
            // long 1
            *data->SIGIN_BOARD0_SATMCU0_LBUTTON_BIT_LONG1 = 1;
            *data->SIGIN_BOARD0_SATMCU0_LBUTTON_BIT_LONG1_not = 0;
        } else {
            // short
            *data->SIGIN_BOARD0_SATMCU0_LBUTTON_BIT_SHORT = 1;
            *data->SIGIN_BOARD0_SATMCU0_LBUTTON_BIT_SHORT_not = 0;
        }
    } else if (reset_timer > 0) {
        reset_timer--;
    } else {
        // reset all
        press_timer = 0;
        *data->SIGIN_BOARD0_SATMCU0_LBUTTON_BIT_SHORT = 0;
        *data->SIGIN_BOARD0_SATMCU0_LBUTTON_BIT_SHORT_not = 1;
        *data->SIGIN_BOARD0_SATMCU0_LBUTTON_BIT_LONG1 = 0;
        *data->SIGIN_BOARD0_SATMCU0_LBUTTON_BIT_LONG1_not = 1;
        *data->SIGIN_BOARD0_SATMCU0_LBUTTON_BIT_LONG2 = 0;
        *data->SIGIN_BOARD0_SATMCU0_LBUTTON_BIT_LONG2_not = 1;
    }
    last = value;
}

void convert_sigin_board0_satmcu0_cbutton_bit(data_t *data) {
    bool value = data->VARIN1_CBUTTON_BIT;
    *data->SIGIN_BOARD0_SATMCU0_CBUTTON_BIT = value;
    *data->SIGIN_BOARD0_SATMCU0_CBUTTON_BIT_not = 1 - value;
}

void convert_sigin_board0_satmcu0_rbutton_bit(data_t *data) {
    bool value = data->VARIN1_RBUTTON_BIT;
    *data->SIGIN_BOARD0_SATMCU0_RBUTTON_BIT = value;
    *data->SIGIN_BOARD0_SATMCU0_RBUTTON_BIT_not = 1 - value;
}

void convert_sigin_board0_satmcu0_rbutton_bit_short(data_t *data) {
    bool value = data->VARIN1_RBUTTON_BIT;
    static bool last = 0;
    static uint16_t press_timer = 0;
    static uint16_t reset_timer = 0;
    if (value == 1) {
        if (press_timer < 9000) {
            press_timer++;
        }
    } else if (last == 1 && value == 0) {
        reset_timer = servo_period * 100 / 1000000;
        if ((servo_period * press_timer / 1000000) > 1500) {
            // long 2
            *data->SIGIN_BOARD0_SATMCU0_RBUTTON_BIT_LONG2 = 1;
            *data->SIGIN_BOARD0_SATMCU0_RBUTTON_BIT_LONG2_not = 0;
        } else if ((servo_period * press_timer / 1000000) > 500) {
            // long 1
            *data->SIGIN_BOARD0_SATMCU0_RBUTTON_BIT_LONG1 = 1;
            *data->SIGIN_BOARD0_SATMCU0_RBUTTON_BIT_LONG1_not = 0;
        } else {
            // short
            *data->SIGIN_BOARD0_SATMCU0_RBUTTON_BIT_SHORT = 1;
            *data->SIGIN_BOARD0_SATMCU0_RBUTTON_BIT_SHORT_not = 0;
        }
    } else if (reset_timer > 0) {
        reset_timer--;
    } else {
        // reset all
        press_timer = 0;
        *data->SIGIN_BOARD0_SATMCU0_RBUTTON_BIT_SHORT = 0;
        *data->SIGIN_BOARD0_SATMCU0_RBUTTON_BIT_SHORT_not = 1;
        *data->SIGIN_BOARD0_SATMCU0_RBUTTON_BIT_LONG1 = 0;
        *data->SIGIN_BOARD0_SATMCU0_RBUTTON_BIT_LONG1_not = 1;
        *data->SIGIN_BOARD0_SATMCU0_RBUTTON_BIT_LONG2 = 0;
        *data->SIGIN_BOARD0_SATMCU0_RBUTTON_BIT_LONG2_not = 1;
    }
    last = value;
}



// Generated by component_buffer_converter()
void convert_outputs(void) {
    // output loop: SIGOUT -> calc -> VAROUT -> txBuffer
    convert_varout32_stepdir0_velocity(data);
    convert_varout1_stepdir0_enable(data);
    convert_varout32_stepdir1_velocity(data);
    convert_varout1_stepdir1_enable(data);
    convert_varout32_stepdir2_velocity(data);
    convert_varout1_stepdir2_enable(data);
    convert_varout16_pwmout0_dty(data);
    convert_varout1_pwmout0_enable(data);
    convert_varout1_bitout0_bit(data);
    convert_varout1_bitout1_bit(data);
    convert_varout1_ledscale0_bit(data);
    convert_varout1_ledscale1_bit(data);
    convert_varout1_ledscale2_bit(data);
    convert_varout1_selectedx_bit(data);
    convert_varout1_selectedy_bit(data);
    convert_varout1_selectedz_bit(data);
}

void convert_inputs(void) {
    // input: rxBuffer -> VAROUT -> calc -> SIGOUT
    convert_sigin_board0_bitin0_bit(data);
    convert_sigin_board0_bitin1_bit(data);
    convert_sigin_board0_bitin2_bit(data);
    convert_sigin_board0_stepdir0_position(data);
    convert_sigin_board0_stepdir1_position(data);
    convert_sigin_board0_stepdir2_position(data);
    convert_sigin_board0_bitin3_bit(data);
    convert_sigin_board0_bitin4_bit(data);
    convert_sigin_board0_bitin5_bit(data);
    convert_sigin_board0_bitin6_bit(data);
    convert_sigin_board0_bitin7_bit(data);
    convert_sigin_board0_satmcu0_feed_position(data);
    convert_sigin_board0_satuart0_timeout(data);
    convert_sigin_board0_satmcu0_spindle_position(data);
    convert_sigin_board0_satmcu0_rapid_position(data);
    convert_sigin_board0_satmcu0_jogwheel_position(data);
    convert_sigin_board0_satmcu0_mpgestop_bit(data);
    convert_sigin_board0_satmcu0_scale0_bit(data);
    convert_sigin_board0_satmcu0_scale1_bit(data);
    convert_sigin_board0_satmcu0_scale2_bit(data);
    convert_sigin_board0_satmcu0_selectx_bit(data);
    convert_sigin_board0_satmcu0_selecty_bit(data);
    convert_sigin_board0_satmcu0_selectz_bit(data);
    convert_sigin_board0_satmcu0_lbutton_bit(data);
    convert_sigin_board0_satmcu0_lbutton_bit_short(data);
    convert_sigin_board0_satmcu0_cbutton_bit(data);
    convert_sigin_board0_satmcu0_rbutton_bit(data);
    convert_sigin_board0_satmcu0_rbutton_bit_short(data);
}

// Generated by component_buffer()
void write_txbuffer(uint8_t *txBuffer) {
    // PC -> FPGA (156 + 68)
    int i = 0;
    for (i = 0; i < BUFFER_SIZE_TX; i++) {
        txBuffer[i] = 0;
    }
    // raw vars to txBuffer
    txBuffer[0] = 0x74;  // 224
    txBuffer[1] = 0x69;  // 216
    txBuffer[2] = 0x72;  // 208
    txBuffer[3] = 0x77;  // 200
    memcpy(&txBuffer[4], &data->VAROUT32_STEPDIR0_VELOCITY, 4);  // 192
    memcpy(&txBuffer[8], &data->VAROUT32_STEPDIR1_VELOCITY, 4);  // 160
    memcpy(&txBuffer[12], &data->VAROUT32_STEPDIR2_VELOCITY, 4);  // 128
    memcpy(&txBuffer[16], &data->VAROUT16_PWMOUT0_DTY, 2);  // 96
    txBuffer[18] |= (data->VAROUT1_STEPDIR0_ENABLE<<7);  // 80
    txBuffer[18] |= (data->VAROUT1_STEPDIR1_ENABLE<<6);  // 79
    txBuffer[18] |= (data->VAROUT1_STEPDIR2_ENABLE<<5);  // 78
    txBuffer[18] |= (data->VAROUT1_PWMOUT0_ENABLE<<4);  // 77
    txBuffer[18] |= (data->VAROUT1_BITOUT0_BIT<<3);  // 76
    txBuffer[18] |= (data->VAROUT1_BITOUT1_BIT<<2);  // 75
    txBuffer[18] |= (data->VAROUT1_LEDSCALE0_BIT<<1);  // 74
    txBuffer[18] |= (data->VAROUT1_LEDSCALE1_BIT<<0);  // 73
    txBuffer[19] |= (data->VAROUT1_LEDSCALE2_BIT<<7);  // 72
    txBuffer[19] |= (data->VAROUT1_SELECTEDX_BIT<<6);  // 71
    txBuffer[19] |= (data->VAROUT1_SELECTEDY_BIT<<5);  // 70
    txBuffer[19] |= (data->VAROUT1_SELECTEDZ_BIT<<4);  // 69
    // FILL: 68
}

void read_rxbuffer(uint8_t *rxBuffer) {
    // FPGA -> PC (219 + 5)
    // memcpy(&header, &rxBuffer[0], 4) // 224;
    memcpy(&fpga_timestamp, &rxBuffer[4], 4);  // 192
    memcpy(&data->MULTIPLEXER_INPUT_VALUE, &rxBuffer[8], 4);
    memcpy(&data->MULTIPLEXER_INPUT_ID, &rxBuffer[12], 1);
    memcpy(&data->VARIN32_STEPDIR0_POSITION, &rxBuffer[13], 4);  // 120
    memcpy(&data->VARIN32_STEPDIR1_POSITION, &rxBuffer[17], 4);  // 88
    memcpy(&data->VARIN32_STEPDIR2_POSITION, &rxBuffer[21], 4);  // 56
    data->VARIN1_BITIN0_BIT = (rxBuffer[25] & (1<<7));  // 24
    data->VARIN1_BITIN1_BIT = (rxBuffer[25] & (1<<6));  // 23
    data->VARIN1_BITIN2_BIT = (rxBuffer[25] & (1<<5));  // 22
    data->VARIN1_BITIN3_BIT = (rxBuffer[25] & (1<<4));  // 21
    data->VARIN1_BITIN4_BIT = (rxBuffer[25] & (1<<3));  // 20
    data->VARIN1_BITIN5_BIT = (rxBuffer[25] & (1<<2));  // 19
    data->VARIN1_BITIN6_BIT = (rxBuffer[25] & (1<<1));  // 18
    data->VARIN1_BITIN7_BIT = (rxBuffer[25] & (1<<0));  // 17
    data->VARIN1_SATUART0_TIMEOUT = (rxBuffer[26] & (1<<7));  // 16
    data->VARIN1_MPGESTOP_BIT = (rxBuffer[26] & (1<<6));  // 15
    data->VARIN1_SCALE0_BIT = (rxBuffer[26] & (1<<5));  // 14
    data->VARIN1_SCALE1_BIT = (rxBuffer[26] & (1<<4));  // 13
    data->VARIN1_SCALE2_BIT = (rxBuffer[26] & (1<<3));  // 12
    data->VARIN1_SELECTX_BIT = (rxBuffer[26] & (1<<2));  // 11
    data->VARIN1_SELECTY_BIT = (rxBuffer[26] & (1<<1));  // 10
    data->VARIN1_SELECTZ_BIT = (rxBuffer[26] & (1<<0));  // 9
    data->VARIN1_LBUTTON_BIT = (rxBuffer[27] & (1<<7));  // 8
    data->VARIN1_CBUTTON_BIT = (rxBuffer[27] & (1<<6));  // 7
    data->VARIN1_RBUTTON_BIT = (rxBuffer[27] & (1<<5));  // 6
    // FILL: 5
    if (data->MULTIPLEXER_INPUT_ID == 0) {;
        memcpy(&data->VARIN32_FEED_POSITION, &data->MULTIPLEXER_INPUT_VALUE, 4);
    }
    if (data->MULTIPLEXER_INPUT_ID == 1) {;
        memcpy(&data->VARIN32_SPINDLE_POSITION, &data->MULTIPLEXER_INPUT_VALUE, 4);
    }
    if (data->MULTIPLEXER_INPUT_ID == 2) {;
        memcpy(&data->VARIN32_RAPID_POSITION, &data->MULTIPLEXER_INPUT_VALUE, 4);
    }
    if (data->MULTIPLEXER_INPUT_ID == 3) {;
        memcpy(&data->VARIN32_JOGWHEEL_POSITION, &data->MULTIPLEXER_INPUT_VALUE, 4);
    }
}

void rio_readwrite(__attribute__((unused)) void *inst, __attribute__((unused)) int64_t period) {
    int ret = 0;
    uint8_t i = 0;
    uint8_t rxBuffer[BUFFER_SIZE_RX * 2];
    uint8_t txBuffer[BUFFER_SIZE_TX * 2];
    int64_t stamp_new = rtapi_get_time();
    float timestamp = (float)fpga_timestamp / (float)OSC_CLOCK;
    *data->duration = timestamp - fpga_stamp_last;
    fpga_stamp_last = timestamp;
    stamp_last = stamp_new;
    servo_period = period;
    if (*data->sys_enable == 1 || *data->sys_enable_request == 1) {
        pkg_counter += 1;
        convert_outputs();
        if (*data->sys_simulation != 1) {
            write_txbuffer(txBuffer);
#ifdef UDP_ASYNC
            ret = udp_rx(rxBuffer, BUFFER_SIZE_RX, 1);
            udp_tx(txBuffer, BUFFER_SIZE_TX);
#else
            udp_tx(txBuffer, BUFFER_SIZE_TX);
            ret = udp_rx(rxBuffer, BUFFER_SIZE_RX, 0);
#endif
            if (ret == BUFFER_SIZE_RX && rxBuffer[0] == 97 && rxBuffer[1] == 116 && rxBuffer[2] == 97 && rxBuffer[3] == 100) {
                if (err_counter > 0) {
                    err_counter = 0;
                    rtapi_print("recovered..\n");
                }
                read_rxbuffer(rxBuffer);
                convert_inputs();
                *data->sys_status = 1;
            } else {
                err_counter += 1;
                err_total += 1;
                if (err_counter < 5) {
                    if (ret != BUFFER_SIZE_RX) {
                        rtapi_print("%li: wrong data size (len %i/%i err %i/3) - (%i %i - %0.4f %%)", stamp_new, ret, BUFFER_SIZE_RX, err_counter, err_total, pkg_counter, (float)err_total * 100.0 / (float)pkg_counter);
                    } else {
                        rtapi_print("%li: wrong header (%i/3) - (%i %i - %0.4f %%):", stamp_new, err_counter, err_total, pkg_counter, (float)err_total * 100.0 / (float)pkg_counter);
                    }
                    for (i = 0; i < ret; i++) {
                        rtapi_print("%d ", rxBuffer[i]);
                    }
                    rtapi_print("\n");
                    if (ret != BUFFER_SIZE_RX) {
                        rtapi_print("  wrong payload size: %i, should be %i\n", ret, BUFFER_SIZE_RX);
                    }
                    if (err_counter > 3) {
                        rtapi_print("too many errors..\n");
                        *data->sys_status = 0;
                        *data->sys_error = 1;
                    }
                }
            }
        } else {
            convert_inputs();
            *data->sys_status = 1;
        }
    } else {
        *data->sys_status = 0;
        *data->sys_error = 0;
    }
}

